// SPDX-License-Identifier: BSD-3-Clause
/*
 * Copyright (c) 2024, Qualcomm Innovation Center, Inc. All rights reserved.
 */
/dts-v1/;

#include "sa8775p-ride.dts"
#include "qcs9075-thermal.dtsi"

/ {
	model = "Qualcomm Technologies, Inc. QCS9075 Ride";
	compatible = "qcom,qcs9075-ride", "qcom,qcs9075", "qcom,sa8775p";
	qcom,msm-id = <676 0x20000>;
	qcom,board-id = <0x10025 1>;
};
