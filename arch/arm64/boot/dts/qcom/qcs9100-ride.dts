// SPDX-License-Identifier: BSD-3-Clause
/*
 * Copyright (c) 2024, Qualcomm Innovation Center, Inc. All rights reserved.
 */
/dts-v1/;

#include "sa8775p-ride.dts"
/ {
	model = "Qualcomm QCS9100 Ride";
	compatible = "qcom,qcs9100-ride", "qcom,qcs9100";
	qcom,msm-id = <667 0x10000>, <667 0x20000>;
	qcom,board-id = <0x10019 0>, <0x10025 1>;
};
