// SPDX-License-Identifier: BSD-3-Clause
/*
 * x1e80100-addons IDP device tree source
 *
 * Copyright (c) 2023 Qualcomm Innovation Center, Inc. All rights reserved.
 *
 */

/dts-v1/;

#include "x1e80100-qcp.dts"
#include "x1e80100-addons.dtsi"

/ {
	model = "Qualcomm Technologies, Inc. X1E80100-addons QCP";
	compatible = "qcom,x1e80100-addons-qcp", "qcom,x1e80100";
};
