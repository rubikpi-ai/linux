// SPDX-License-Identifier: BSD-3-Clause
/*
 * Copyright (c) 2024, Qualcomm Innovation Center, Inc. All rights reserved.
 */
/dts-v1/;

#include "qcs9075-ride-r3.dts"
#include "sa8775p-addons-ride.dtsi"

/ {
	model = "Qualcomm Technologies, Inc. QCS9075 Addons Ride Rev3";
	compatible = "qcom,qcs9075-addons-ride-r3", "qcom,qcs9075", "qcom,sa8775p";
};
