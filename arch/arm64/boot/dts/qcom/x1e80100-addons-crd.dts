// SPDX-License-Identifier: BSD-3-Clause
/*
 * x1e80100-addons CRD device tree source
 *
 * Copyright (c) 2023 Qualcomm Innovation Center, Inc. All rights reserved.
 *
 */

/dts-v1/;

#include "x1e80100-crd.dts"
#include "x1e80100-addons.dtsi"

/ {
	model = "Qualcomm Technologies, Inc. X1E80100-addons CRD";
	compatible = "qcom,x1e80100-addons-crd", "qcom,x1e80100";
};
