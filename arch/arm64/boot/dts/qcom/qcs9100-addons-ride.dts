// SPDX-License-Identifier: BSD-3-Clause
/*
 * Copyright (c) 2024 Qualcomm Innovation Center, Inc. All rights reserved.
 */

/dts-v1/;

#include "qcs9100-ride.dts"
#include "sa8775p-addons-ride.dtsi"

/ {
	model = "Qualcomm QCS9100 Ride";
	compatible = "qcom,qcs9100-addons-ride", "qcom,qcs9100", "qcom,sa8775p";
};
