// SPDX-License-Identifier: BSD-3-Clause
/*
 * Copyright (c) 2024 Qualcomm Innovation Center, Inc. All rights reserved.
 */

/dts-v1/;

#include "sa8775p-ride-r3.dts"
#include "sa8775p-addons-ride.dtsi"

/ {
	model = "Qualcomm SA8775P Ride Rev3";
	compatible = "qcom,sa8775p-addons-ride-r3", "qcom,sa8775p";
};
