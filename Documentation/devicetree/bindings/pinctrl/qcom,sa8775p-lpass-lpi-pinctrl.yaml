## Documentation/devicetree/bindings/sound/qcom,msm-stub-codec.yaml
```yaml
# SPDX-License-Identifier: (GPL-2.0-only OR BSD-2-Clause)
%YAML 1.2
---
$id: http://devicetree.org/schemas/sound/qcom,msm-stub-codec.yaml#
$schema: http://devicetree.org/meta-schemas/core.yaml#

title: Qualcomm Technologies Inc. msm stub audio codec driver

maintainers:
  - Rohit kumar <quic_rohkumar@quicinc.com>
  - Amarnath Vangala <quic_avangala@quicinc.com>

properties:
  compatible:
    enum:
      - qcom,msm-stub-codec

required:
  - compatible

unevaluatedProperties: false

examples:
  - |
          msm_stub_codec: msm-stub-codec {
                  compatible = "qcom,msm-stub-codec";
                  #sound-dai-cells = <1>;
          };
```

## Documentation/devicetree/bindings/sound/qcom,spf-core-platform.yaml
```yaml
# SPDX-License-Identifier: (GPL-2.0-only OR BSD-2-Clause)
%YAML 1.2
---
$id: http://devicetree.org/schemas/sound/qcom,spf-core-platform.yaml#
$schema: http://devicetree.org/meta-schemas/core.yaml#

title: Qualcomm Technologies Inc. spf core platform msm audio memory driver

maintainers:
  - Rohit kumar <quic_rohkumar@quicinc.com>
  - Amarnath Vangala <quic_avangala@quicinc.com>

properties:
  compatible:
    enum:
      - qcom,spf-core-platform
      - qcom,msm-audio-mem

required:
  - compatible

unevaluatedProperties: false

examples:
  - |
       spf_core_platform: spf_core_platform {
                compatible = "qcom,spf-core-platform";

                msm_audio_mem: msm-audio-mem {
                        compatible = "qcom,msm-audio-mem";
                        qcom,smmu-version = <2>;
                        qcom,smmu-enabled;
                        iommus = <&apps_smmu 0x1801 0x0>;
                        qcom,iommu-dma-addr-pool = <0x10000000 0x10000000>;
                        qcom,smmu-sid-mask = /bits/ 64 <0xf>;
                        dma-coherent;
                };
       };
```

## Documentation/devicetree/bindings/thermal/qcom,qmi-cooling.yaml
```yaml
# SPDX-License-Identifier: (GPL-2.0 OR BSD-2-Clause)
# Copyright 2023 (c), Linaro Limited

%YAML 1.2
---
$id: http://devicetree.org/schemas/thermal/qcom,qmi-cooling.yaml#
$schema: http://devicetree.org/meta-schemas/core.yaml#

title: Qualcomm QMI based thermal mitigation (TMD) cooling devices.

maintainers:
  - Caleb Connolly <caleb.connolly@linaro.org>

description:
  Qualcomm QMI based TMD cooling device(s) are used for various mitigations for
  remote subsystem(s) including remote processor mitigation, rail voltage
  restriction etc. Some devices such as "cpuv_restriction_cold" are for warming,
  (e.g. by raising minimum voltage on core system rails).

  Each subnode represents a control for a single instance of the TMD service running
  on a remote subsystem.

definitions:
  tmd:
    type: object
    description: |
      A single Thermal Mitigation Device exposed by a remote subsystem.
    properties:
      label:
        maxItems: 1
      "#cooling-cells":
        $ref: /schemas/thermal/thermal-cooling-devices.yaml#/properties/#cooling-cells

    required:
      - label
      - "#cooling-cells"

    additionalProperties: false

properties:
  compatible:
    enum:
      - qcom,qmi-cooling-modem
      - qcom,qmi-cooling-adsp
      - qcom,qmi-cooling-cdsp
      - qcom,qmi-cooling-cdsp1
      - qcom,qmi-cooling-slpi

  vdd:
    $ref: "#/definitions/tmd"
    description:
      Restrict primary rail minimum voltage to "nominal" setting.
    properties:
      label:
        const: cpuv_restriction_cold

required:
  - compatible
  - vdd

# Modem has additional TMDs
allOf:
  - if:
      properties:
        compatible:
          contains:
            const: qcom,qmi-cooling-modem
    then:
      properties:
        pa:
          $ref: "#/definitions/tmd"
          description:
            Power Amplifier TMD
          properties:
            label:
              const: pa

        proc:
          $ref: "#/definitions/tmd"
          description:
            Modem processor temperature TMD
          properties:
            label:
              const: modem

        current:
          $ref: "#/definitions/tmd"
          description:
            Modem peak current TMD
          properties:
            label:
              const: modem_current

        skin:
          $ref: "#/definitions/tmd"
          description:
            Modem skin temperature TMD
          properties:
            label:
              const: modem_skin

unevaluatedProperties: false

examples:
  - |
    remoteproc-modem {
        cooling {
            compatible = "qcom,qmi-cooling-modem";

            modem_pa: pa {
              label = "pa";
              #cooling-cells = <2>;
            };

            modem_proc: proc {
              label = "modem";
              #cooling-cells = <2>;
            };

            modem_current: current {
              label = "modem_current";
              #cooling-cells = <2>;
            };

            modem_skin: skin {
              label = "modem_skin";
              #cooling-cells = <2>;
            };

            modem_vdd: vdd {
              label = "cpuv_restriction_cold";
              #cooling-cells = <2>;
            };
        };
    };

    remoteproc-adsp {
        cooling {
            compatible = "qcom,qmi-cooling-adsp";

            adsp_vdd: vdd {
              label = "cpuv_restriction_cold";
              #cooling-cells = <2>;
            };
        };
    };

    remoteproc-cdsp {
        cooling {
            compatible = "qcom,qmi-cooling-cdsp";

            cdsp_vdd: vdd {
              label = "cpuv_restriction_cold";
              #cooling-cells = <2>;
            };
        };
    };

    remoteproc-slpi {
        cooling {
            compatible = "qcom,qmi-cooling-slpi";

            slpi_vdd: vdd {
              label = "cpuv_restriction_cold";
              #cooling-cells = <2>;
            };
        };
    };
...
```

## Documentation/devicetree/bindings/usb/usb5807.yaml
```yaml
# SPDX-License-Identifier: (GPL-2.0 OR BSD-2-Clause)
%YAML 1.2
---
$id: http://devicetree.org/schemas/usb/usb5807.yaml#
$schema: http://devicetree.org/meta-schemas/core.yaml#

title: Microchip USB 3.1 SuperSpeed Hub Controller

maintainers:
  - Mike Looijmans <mike.looijmans@topic.nl>

properties:
  compatible:
    enum:
      - microchip,usb5807

  reg:
    maxItems: 1

  reset-gpios:
    description: |
      Should specify the gpio for hub reset

  swap-dx-lanes:
    $ref: /schemas/types.yaml#/definitions/uint8-array
    description: |
      Specifies the ports which will swap the differential-pair (D+/D-),
      default is not-swapped.

additionalProperties: false

required:
  - compatible
  - reg

examples:
  - |
    #include <dt-bindings/gpio/gpio.h>

    i2c {
      #address-cells = <1>;
      #size-cells = <0>;

      usb-hub@2d {
        compatible = "microchip,usb5807";
        reg = <0x2d>;
        reset-gpios = <&gpio1 4 GPIO_ACTIVE_LOW>;
        /* Swapped D+/D- on port 0 */
        swap-dx-lanes = <0>;
      };
    };
```

## Documentation/devicetree/bindings/watchdog/qcom_gh_watchdog.yaml
```yaml
# SPDX-License-Identifier: GPL-2.0-only OR BSD-2-Clause
%YAML 1.2
---
$id: http://devicetree.org/schemas/bindings/watchdog/qcom_gh_watchdog.yaml#
$schema: http://devicetree.org/meta-schemas/core.yaml#

title: QTI GH Watchdog

maintainers:
 Shivendra Pratap <quic_spratap@quicinc.com>

description:
  Watchdog timer is configured with a bark and a bite time.
  If the watchdog is not "pet" at regular intervals, the system
  is assumed to have become non responsive and needs to be reset.
  A warning in the form of a bark timeout leads to a bark interrupt
  and a kernel panic. If the watchdog timer is still not reset,
  a bite timeout occurs, which leads to a reset of the VM via
  the hypervisor. The driver needs the petting time, and the bark
  timeout to be programmed into the watchdog, as well as the bark irq.

properties:
  compatible:
    const: qcom,gh-watchdog

  interrupts:
    description: Specifies Watchdog bark interrupt
    maxItems: 1

required:
  - compatible
  - interrupts

example:
  - |
    wdog_gh: qcom,wdt_gh {
	    compatible = "qcom,gh-watchdog";
	    interrupts = <0 0 IRQ_TYPE_LEVEL_HIGH>;
    };
```

## drivers/firmware/qcom/Kconfig
```kconfig
# SPDX-License-Identifier: GPL-2.0-only
menu "Qualcomm firmware drivers"

config QCOM_TZMEM
	tristate "QCOM_TZMEM"
	select GENERIC_ALLOCATOR

choice
	prompt "TrustZone interface memory allocator mode"
	depends on QCOM_TZMEM
	default QCOM_TZMEM_MODE_GENERIC
	help
	  Selects the mode of the memory allocator providing memory buffers of
	  suitable format for sharing with the TrustZone. If in doubt, select
	  'Generic'.

config QCOM_TZMEM_MODE_GENERIC
	bool "Generic"
	help
	  Use the generic allocator mode. The memory is page-aligned, non-cachable
	  and physically contiguous.

config QCOM_TZMEM_MODE_SHMBRIDGE
	bool "SHM Bridge"
	help
	  Use Qualcomm Shared Memory Bridge. The memory has the same alignment as
	  in the 'Generic' allocator but is also explicitly marked as an SHM Bridge
	  buffer.

	  With this selected, all buffers passed to the TrustZone must be allocated
	  using the TZMem allocator or else the TrustZone will refuse to use them.

endchoice

config QTI_TZ_LOG
	tristate "QTI Trust Zone (TZ) Log Driver"
	depends on QTEE_SHM_BRIDGE && PROC_FS
	help
	  Provide debugging capability with a procfs interface for messages produced
	  by the Secure code (Trust zone). These messages provide diagnostic information
	  about TZ operations.

endmenu
```

## drivers/firmware/qcom/si_core/Kconfig
```kconfig
# SPDX-License-Identifier: GPL-2.0-only

config QCOM_SI_CORE
	tristate "Secure QTEE Communication Support"
	depends on QCOM_SCM_ADDON && QCOM_TZMEM
	help
	  Enable SI-CORE driver which supports capability based secure
	  communication between QTEE and VM. Using SI-CORE, kernel can
	  issue calls to QTEE or TAs to request a service or exposes services
	  to QTEE and TAs. The SI-CORE implements the necessary marshaling of
	  messages with QTEE.

config QCOM_SI_CORE_ADCI
	bool "Use ADCI thread to cater service requests from other VMs"
	depends on QCOM_SI_CORE
	help
	  Use a kernel thread to register callback service to QTEE that
	  will cater requests initiated by other VMs requiring services
	  hosted by primary VM.

	  Enable if there are multiple VMs and services are hosted only
	  by primary VM.

config QCOM_SI_CORE_WQ
	bool "Use direct invocation for RELEASE requests"
	depends on QCOM_SI_CORE
	help
	  Use a kernel thread to issue RELEASE request to QTEE and TAs
	  instead of using asynchronous messages. It may slow down the system
	  and prone to failure as it uses direct invocation which requires
	  extra resources from QTEE.

	  Enable if only QTEE does not support asynchronous message.

config QCOM_SI_CORE_MEM_OBJECT
	tristate "Add support for memory object"
	depends on QCOM_SI_CORE
	help
	  Enable support for memory object. This provide an interface
	  to export or sharing memory with QTEE. It allows kernel clients
	  to create memory object and do the necessary mapping and unmapping
	  using QTEE shared memory driver.

source "drivers/firmware/qcom/si_core/si_core_xts/Kconfig"
```

## drivers/firmware/qcom/si_core/si_core_xts/Kconfig
```kconfig
# SPDX-License-Identifier: GPL-2.0-only
#
# QCOM SI-CORE XTS driver
#
config QCOM_SI_CORE_XTS
	tristate "Secure QSEE Support"
	depends on QCOM_SI_CORE
	help
	  Enable SMCInvoke driver which supports capability based secure
	  communication between QTI Secure Execution Environment (QSEE)
	  and high level operating system. It exposes APIs for both
	  userspace and kernel clients.
```

## drivers/pci/controller/misc/Kconfig
```kconfig
# SPDX-License-Identifier: GPL-2.0
config QCOM_QPS615_PCIE_SWITCH
	bool "QCOM QPS615 PCIe Switch Driver"
	depends on PCI
	help
	 This adds support to enable QPS615 PCIe switch power. And after powering on the switch do
	 switch initialization through I2C writes. The I2C data is parsed from the requested
	 firmware.

	 Say Y to compile this driver.
```
