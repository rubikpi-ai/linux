## drivers/thermal/qcom/Kconfig
```kconfig
# SPDX-License-Identifier: GPL-2.0-only
config QCOM_TSENS
	tristate "Qualcomm TSENS Temperature Alarm"
	depends on NVMEM_QCOM_QFPROM
	depends on ARCH_QCOM || COMPILE_TEST
	help
	  This enables the thermal sysfs driver for the TSENS device. It shows
	  up in Sysfs as a thermal zone with multiple trip points. Disabling the
	  thermal zone device via the mode file results in disabling the sensor.
	  Also able to set threshold temperature for both hot and cold and update
	  when a threshold is reached.

config QCOM_SPMI_ADC_TM5
	tristate "Qualcomm SPMI PMIC Thermal Monitor ADC5"
	depends on OF && SPMI && IIO
	select REGMAP_SPMI
	select QCOM_VADC_COMMON
	help
	  This enables the thermal driver for the ADC thermal monitoring
	  device. It shows up as a thermal zone with multiple trip points.
	  Thermal client sets threshold temperature for both warm and cool and
	  gets updated when a threshold is reached.

config QCOM_SPMI_MBG_TM
	tristate "Qualcomm Technologies, Inc. SPMI PMIC MBG Temperature monitor"
	depends on OF && SPMI && IIO
	select REGMAP_SPMI
	help
	 This enables a thermal driver for the MBG thermal monitoring device.
	 It shows up in sysfs as a thermal sensor with two trip points.
	 It notifies the thermal framework when level 1 high threshold is
	 violated. The temperature reported by the thermal sensor reflects
	 the real time die temperature through ADC channel.

config QCOM_SPMI_TEMP_ALARM
	tristate "Qualcomm SPMI PMIC Temperature Alarm"
	depends on OF && SPMI && IIO
	select REGMAP_SPMI
	help
	  This enables a thermal sysfs driver for Qualcomm plug-and-play (QPNP)
	  PMIC devices. It shows up in sysfs as a thermal sensor with multiple
	  trip points. The temperature reported by the thermal sensor reflects the
	  real time die temperature if an ADC is present or an estimate of the
	  temperature based upon the over temperature stage value.

config QCOM_LMH
	tristate "Qualcomm Limits Management Hardware"
	depends on ARCH_QCOM && QCOM_SCM
	help
	  This enables initialization of Qualcomm limits management
	  hardware(LMh). LMh allows for hardware-enforced mitigation for cpus based on
	  input from temperature and current sensors.  On many newer Qualcomm SoCs
	  LMh is configured in the firmware and this feature need not be enabled.
	  However, on certain SoCs like sdm845 LMh has to be configured from kernel.

config QCOM_QMI_COOLING
	tristate "Qualcomm QMI cooling drivers"
	depends on QCOM_RPROC_COMMON
	depends on ARCH_QCOM || COMPILE_TEST
	select QCOM_QMI_HELPERS
	help
	   This enables the remote subsystem cooling devices. These cooling
	   devices will be used by Qualcomm chipset to place various remote
	   subsystem mitigations like remote processor passive mitigation,
	   remote subsystem voltage restriction at low temperatures etc.
	   The QMI cooling device will interface with remote subsystem
	   using Qualcomm remoteproc interface.

config QTI_BCL_PMIC5
	tristate "BCL driver for BCL peripherals in PMIC5"
	depends on SPMI && THERMAL
	help
	  This driver provides routines to configure and monitor the BCL
	  PMIC peripheral. This driver registers the battery current and
	  voltage sensors with the thermal core framework and can take
	  threshold input and notify the thermal core when the threshold is
	  reached.

config QTI_DEVFREQ_CDEV
	tristate "QTI Devfreq cooling device"
	depends on PM_DEVFREQ && THERMAL && PM_OPP
	help
	   This enables the QTI devfreq cooling device, which
	   will help register the devfreq cooling devices with
	   thermal framework and allow limiting the devfreq
	   frequency.
```
