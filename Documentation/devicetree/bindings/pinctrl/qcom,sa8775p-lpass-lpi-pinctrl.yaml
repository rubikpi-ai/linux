## Documentation/devicetree/bindings/remoteproc/qcom,pas-common.yaml
```yaml
# SPDX-License-Identifier: GPL-2.0 OR BSD-2-Clause
%YAML 1.2
---
$id: http://devicetree.org/schemas/remoteproc/qcom,pas-common.yaml#
$schema: http://devicetree.org/meta-schemas/core.yaml#

title: Qualcomm Peripheral Authentication Service Common Properties

maintainers:
  - Manivannan Sadhasivam <manivannan.sadhasivam@linaro.org>

description:
  Common properties of Qualcomm SoCs Peripheral Authentication Service.

properties:
  clocks:
    minItems: 1
    maxItems: 2

  clock-names:
    minItems: 1
    maxItems: 2

  interconnects:
    maxItems: 1

  interrupts:
    minItems: 5
    items:
      - description: Watchdog interrupt
      - description: Fatal interrupt
      - description: Ready interrupt
      - description: Handover interrupt
      - description: Stop acknowledge interrupt
      - description: Shutdown acknowledge interrupt

  interrupt-names:
    minItems: 5
    items:
      - const: wdog
      - const: fatal
      - const: ready
      - const: handover
      - const: stop-ack
      - const: shutdown-ack

  power-domains:
    minItems: 1
    maxItems: 3

  power-domain-names:
    minItems: 1
    maxItems: 3

  iommus:
    maxItems: 1

  qcom,devmem:
    $ref: /schemas/types.yaml#/definitions/uint32-matrix
    description:
      Qualcomm’s PAS implementation for remote processors only supports a
      single stage of IOMMU translation and is presently managed by the
      Qualcomm EL2 hypervisor (QHEE) if it is present. In the absence of QHEE,
      such as with a KVM hypervisor, IOMMU translations need to be set up by
      the KVM host. Remoteproc might need some device resources and related
      access permissions to be set before it comes up, and this information is
      presently available statically with QHEE.

      In the absence of QHEE, the boot firmware needs to overlay this
      information based on SoCs running with either QHEE or a KVM hypervisor
      (CPUs booted in EL2).

      The qcom,devmem property provides IOMMU devmem translation information
      intended for non-QHEE based systems. It is an array of u32 values
      describing the device memory regions for which IOMMU translations need to
      be set up before bringing up Remoteproc. This array consists of 4-tuples
      defining the device address, physical address, size, and attribute flags
      with which it has to be mapped.

      remoteproc@3000000 {
          ...

          qcom,devmem = <0x82000 0x82000 0x2000 0x3>,
                        <0x92000 0x92000 0x1000 0x1>;
      }

    items:
      items:
        - description: device address
        - description: physical address
        - description: size of mapping
        - description: |
            iommu attributes - IOMMU_READ, IOMMU_WRITE, IOMMU_CACHE, IOMMU_NOEXEC, IOMMU_MMIO
          enum: [ 1, 2, 3, 4, 5, 6, 7, 8, 9, 10, 11, 12, 13, 14, 15, 16, 17, 18, 19, 20, 21, 22, 23, 24,
                  25, 26, 27, 28, 29, 30, 31 ]

  qcom,smem-states:
    $ref: /schemas/types.yaml#/definitions/phandle-array
    description: States used by the AP to signal the Hexagon core
    items:
      - description: Stop the modem

  qcom,smem-state-names:
    description: The names of the state bits used for SMP2P output
    items:
      - const: stop

  smd-edge:
    $ref: /schemas/remoteproc/qcom,smd-edge.yaml#
    description:
      Qualcomm Shared Memory subnode which represents communication edge,
      channels and devices related to the ADSP.
    unevaluatedProperties: false

  glink-edge:
    $ref: /schemas/remoteproc/qcom,glink-edge.yaml#
    description:
      Qualcomm G-Link subnode which represents communication edge, channels
      and devices related to the ADSP.
    unevaluatedProperties: false

  cooling:
    $ref: /schemas/thermal/qcom,qmi-cooling.yaml#
    description:
      Cooling subnode which represents the cooling devices exposed by the Modem.
    unevaluatedProperties: false

required:
  - clocks
  - clock-names
  - interrupts
  - interrupt-names
  - qcom,smem-states
  - qcom,smem-state-names

additionalProperties: true
```

## Documentation/devicetree/bindings/remoteproc/qcom,sa8775p-pas.yaml
```yaml
# SPDX-License-Identifier: GPL-2.0 OR BSD-2-Clause
%YAML 1.2
---
$id: http://devicetree.org/schemas/remoteproc/qcom,sa8775p-pas.yaml#
$schema: http://devicetree.org/meta-schemas/core.yaml#

title: Qualcomm SA8775p Peripheral Authentication Service

maintainers:
  - Tengfei Fan <quic_tengfan@quicinc.com>

description:
  Qualcomm SA8775p SoC Peripheral Authentication Service loads and boots
  firmware on the Qualcomm DSP Hexagon cores.

properties:
  compatible:
    enum:
      - qcom,qcs8300-adsp-pas
      - qcom,qcs8300-cdsp-pas
      - qcom,qcs8300-gpdsp-pas
      - qcom,sa8775p-adsp-pas
      - qcom,sa8775p-cdsp-pas
      - qcom,sa8775p-cdsp1-pas
      - qcom,sa8775p-gpdsp0-pas
      - qcom,sa8775p-gpdsp1-pas

  reg:
    maxItems: 1

  clocks:
    items:
      - description: XO clock

  clock-names:
    items:
      - const: xo

  qcom,qmp:
    $ref: /schemas/types.yaml#/definitions/phandle
    description: Reference to the AOSS side-channel message RAM.

  smd-edge: false

  memory-region:
    maxItems: 1
    description: Reference to the reserved-memory for the Hexagon core

  firmware-name:
    $ref: /schemas/types.yaml#/definitions/string
    description: Firmware name for the Hexagon core

required:
  - compatible
  - reg
  - memory-region

allOf:
  - $ref: /schemas/remoteproc/qcom,pas-common.yaml#
  - if:
      properties:
        compatible:
          enum:
            - qcom,qcs8300-adsp-pas
            - qcom,qcs8300-cdsp-pas
            - qcom,qcs8300-gpdsp-pas
            - qcom,sa8775p-adsp-pas
            - qcom,sa8775p-cdsp-pas
            - qcom,sa8775p-cdsp1-pas
            - qcom,sa8775p-gpdsp0-pas
            - qcom,sa8775p-gpdsp1-pas
    then:
      properties:
        interrupts:
          maxItems: 5
        interrupt-names:
          maxItems: 5
    else:
      properties:
        interrupts:
          minItems: 6
        interrupt-names:
          minItems: 6

  - if:
      properties:
        compatible:
          enum:
            - qcom,qcs8300-adsp-pas
            - qcom,sa8775p-adsp-pas
    then:
      properties:
        power-domains:
          items:
            - description: LCX power domain
            - description: LMX power domain
        power-domain-names:
          items:
            - const: lcx
            - const: lmx

  - if:
      properties:
        compatible:
          enum:
            - qcom,qcs8300-cdsp-pas
            - qcom,sa8775p-cdsp-pas
    then:
      properties:
        power-domains:
          items:
            - description: CX power domain
            - description: MXC power domain
            - description: NSP0 power domain
        power-domain-names:
          items:
            - const: cx
            - const: mxc
            - const: nsp0

  - if:
      properties:
        compatible:
          enum:
            - qcom,sa8775p-cdsp1-pas
    then:
      properties:
        power-domains:
          items:
            - description: CX power domain
            - description: MXC power domain
            - description: NSP0 power domain
        power-domain-names:
          items:
            - const: cx
            - const: mxc
            - const: nsp0

  - if:
      properties:
        compatible:
          enum:
            - qcom,qcs8300-gpdsp-pas
            - qcom,sa8775p-gpdsp0-pas
    then:
      properties:
        power-domains:
          items:
            - description: CX power domain
            - description: MXC power domain
        power-domain-names:
          items:
            - const: cx
            - const: mxc

  - if:
      properties:
        compatible:
          enum:
            - qcom,sa8775p-gpdsp1-pas
    then:
      properties:
        power-domains:
          items:
            - description: CX power domain
            - description: MXC power domain
        power-domain-names:
          items:
            - const: cx
            - const: mxc

unevaluatedProperties: false

examples:
  - |
    #include <dt-bindings/clock/qcom,rpmh.h>
    #include <dt-bindings/interrupt-controller/irq.h>
    #include <dt-bindings/mailbox/qcom-ipcc.h>
    #include <dt-bindings/power/qcom,rpmhpd.h>

    remoteproc@30000000 {
        compatible = "qcom,sa8775p-adsp-pas";
        reg = <0x030000000 0x100>;

        clocks = <&rpmhcc RPMH_CXO_CLK>;
        clock-names = "xo";

        firmware-name = "qcom/sa8775p/adsp.mbn";

        interrupts-extended = <&pdc 6 IRQ_TYPE_EDGE_RISING>,
                              <&smp2p_adsp_in 0 IRQ_TYPE_EDGE_RISING>,
                              <&smp2p_adsp_in 1 IRQ_TYPE_EDGE_RISING>,
                              <&smp2p_adsp_in 2 IRQ_TYPE_EDGE_RISING>,
                              <&smp2p_adsp_in 3 IRQ_TYPE_EDGE_RISING>;
        interrupt-names = "wdog", "fatal", "handover",
                          "ready", "stop-ack";

        memory-region = <&adsp_mem>;

        power-domains = <&rpmhpd RPMHPD_LCX>,
                        <&rpmhpd RPMHPD_LMX>;
        power-domain-names = "lcx", "lmx";

        qcom,qmp = <&aoss_qmp>;
        qcom,smem-states = <&smp2p_adsp_out 0>;
        qcom,smem-state-names = "stop";

        glink-edge {
            interrupts-extended = <&ipcc IPCC_CLIENT_LPASS
                                         IPCC_MPROC_SIGNAL_GLINK_QMP
                                         IRQ_TYPE_EDGE_RISING>;
            mboxes = <&ipcc IPCC_CLIENT_LPASS IPCC_MPROC_SIGNAL_GLINK_QMP>;

            label = "lpass";
            qcom,remote-pid = <2>;

            /* ... */
        };
    };
```

## Documentation/devicetree/bindings/serial/qcom,serial-geni-qcom.yaml
```yaml
# SPDX-License-Identifier: (GPL-2.0-only OR BSD-2-Clause)
%YAML 1.2
---
$id: http://devicetree.org/schemas/serial/qcom,serial-geni-qcom.yaml#
$schema: http://devicetree.org/meta-schemas/core.yaml#

title: Qualcomm Geni based QUP UART interface

maintainers:
  - Andy Gross <agross@kernel.org>
  - Bjorn Andersson <bjorn.andersson@linaro.org>

allOf:
  - $ref: /schemas/serial/serial.yaml#

  - if:
      properties:
        compatible:
          contains:
            enum:
              - qcom,sa7255p-geni-uart
              - qcom,sa7255p-geni-debug-uart
              - qcom,sa8255p-geni-uart
              - qcom,sa8255p-geni-debug-uart
    then:
      required:
        - power-domains
        - power-domain-names
      properties:
        power-domains:
          minItems: 2
          maxItems: 2
    else:
      required:
        - clocks
        - clock-names
      properties:
        power-domains:
          maxItems: 1
        interconnects:
          maxItems: 2
        interconnect-names:
          items:
            - const: qup-core
            - const: qup-config

properties:
  compatible:
    enum:
      - qcom,geni-uart
      - qcom,geni-debug-uart
      - qcom,sa7255p-geni-uart
      - qcom,sa7255p-geni-debug-uart
      - qcom,sa8255p-geni-uart
      - qcom,sa8255p-geni-debug-uart

  clocks:
    maxItems: 1

  clock-names:
    const: se

  interconnects:
    description: phandles of interconnect bw provider

  interconnect-names:
    description: names of interconnects

  interrupts:
    minItems: 1
    items:
      - description: UART core irq
      - description: Wakeup irq (RX GPIO)

  operating-points-v2: true

  pinctrl-0: true
  pinctrl-1: true

  pinctrl-names:
    minItems: 1
    items:
      - const: default
      - const: sleep

  power-domains:
    minItems: 1
    maxItems: 2

  power-domain-names:
    items:
      - const: power
      - const: perf

  reg:
    maxItems: 1

required:
  - compatible
  - interrupts
  - reg

unevaluatedProperties: false

examples:
  - |
    #include <dt-bindings/interrupt-controller/arm-gic.h>
    #include <dt-bindings/clock/qcom,gcc-sc7180.h>
    #include <dt-bindings/interconnect/qcom,sc7180.h>

    serial@a88000 {
        compatible = "qcom,geni-uart";
        reg = <0xa88000 0x7000>;
        interrupts = <GIC_SPI 355 IRQ_TYPE_LEVEL_HIGH>;
        clock-names = "se";
        clocks = <&gcc GCC_QUPV3_WRAP0_S0_CLK>;
        pinctrl-0 = <&qup_uart0_default>;
        pinctrl-names = "default";
        interconnects = <&qup_virt MASTER_QUP_CORE_0 0 &qup_virt SLAVE_QUP_CORE_0 0>,
                        <&gem_noc MASTER_APPSS_PROC 0 &config_noc SLAVE_QUP_0 0>;
        interconnect-names = "qup-core", "qup-config";
    };

  - |
    #include <dt-bindings/interrupt-controller/arm-gic.h>

    serial@990000 {
        compatible = "qcom,sa8255p-geni-uart";
        reg = <0x990000 0x4000>;
        interrupts = <GIC_SPI 531 IRQ_TYPE_LEVEL_HIGH>;
        power-domains = <&scmi11_pd 4>, <&scmi11_dvfs 4>;
        power-domain-names = "power", "perf";
    };
...
```

## Documentation/devicetree/bindings/soc/qcom/qcom,imem-mem-dump.yaml
```yaml
# SPDX-License-Identifier: GPL-2.0-only OR BSD-2-Clause
%YAML 1.2
---
$id: http://devicetree.org/schemas/soc/qcom/qcom,mem-dump.yaml#
$schema: http://devicetree.org/meta-schemas/core.yaml#

title: Memory dump table region

maintainers:
  - Zhenhua Huang <quic_zhenhuah@quicinc.com>
  - Mao Jinlong <quic_jinlmao@quicinc.com>

description: |
  Memory dump region is which to provide hints(id and size) of
  debugging information based on specified protocols with firmware.
  Firmware then does the real data capture. The debugging information includes
  cache contents, internal memory, registers. After crash and warm reboot,
  firmware scans ids, sizes and stores contents into reserved memory accordingly.
  Firmware then enters into full dump mode which dumps whole DDR to PC through USB.

properties:
  compatible:
    const: "qcom,msm-imem-mem-dump-table"

  reg:
    maxItems: 2

required:
  - compatible
  - reg

additionalProperties: false

examples:
  - |
        mem-dump-table@10 {
               compatible = "qcom,msm-imem-mem-dump-table";
               reg = <0x10 0x8>;
        };

...
```

## Documentation/devicetree/bindings/soc/qcom/qcom,tee-shared-memory-bridge.yaml
```yaml
# SPDX-License-Identifier: (GPL-2.0-only OR BSD-2-Clause)
%YAML 1.2
---
$id: "http://devicetree.org/schemas/soc/qcom/qcom,tee-shared-memory-bridge.yaml#"
$schema: "http://devicetree.org/meta-schemas/core.yaml#"

title: Qualcomm Technologies, Inc. Trusted execution environment shared memory bridge binding

maintainers:
  - Anmolpreet Kaur <quic_anmolpre@quicinc.com>

description:
  QTEE shared memory bridge driver is used to share memory between non-secure
  world and trustzone through shared memory bridge.

properties:
  compatible:
    const: qcom,tee-shared-memory-bridge

  qcom,custom-bridge-size:
    $ref: /schemas/types.yaml#/definitions/uint32
    description: Indicates size of SHM Bridge to be supported in multiples of 4K

  qcom,disable-shmbridge-support:
    type: boolean
    description:
      Disable shmbridge mechanism and fallback to default hyp based mechanism.

required:
  - compatible

optional:
  - qcom,custom-bridge-size
  - qcom,disable-shmbridge-support

examples:
  - |
    firmware {
        qtee_shmbridge {
            compatible = "qcom,tee-shared-memory-bridge";
            qcom,custom-bridge-size = <256>;
        };
    };
```
