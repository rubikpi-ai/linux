## Documentation/devicetree/bindings/display/msm/qcom,qcs8300-mdss.yaml
```yaml
# SPDX-License-Identifier: GPL-2.0-only OR BSD-2-Clause
%YAML 1.2
---
$id: http://devicetree.org/schemas/display/msm/qcom,qcs8300-mdss.yaml#
$schema: http://devicetree.org/meta-schemas/core.yaml#

title: Qualcomm Technologies, Inc. QCS8300 Display MDSS

maintainers:
  - Yongxing Mou <quic_yongmou@quicinc.com>

description:
  QCS8300 MSM Mobile Display Subsystem(MDSS), which encapsulates sub-blocks like
  DPU display controller, DP interfaces and EDP etc.

$ref: /schemas/display/msm/mdss-common.yaml#

properties:
  compatible:
    const: qcom,qcs8300-mdss

  clocks:
    items:
      - description: Display AHB
      - description: Display hf AXI
      - description: Display core

  iommus:
    maxItems: 1

  interconnects:
    maxItems: 3

  interconnect-names:
    maxItems: 3

patternProperties:
  "^display-controller@[0-9a-f]+$":
    type: object
    properties:
      compatible:
        const: qcom,qcs8300-dpu

  "^displayport-controller@[0-9a-f]+$":
    type: object
    properties:
      compatible:
        items:
          - const: qcom,qcs8300-dp

required:
  - compatible

unevaluatedProperties: false

examples:
  - |
    #include <dt-bindings/clock/qcom,sa8775p-dispcc.h>
    #include <dt-bindings/clock/qcom,qcs8300-gcc.h>
    #include <dt-bindings/clock/qcom,rpmh.h>
    #include <dt-bindings/interrupt-controller/arm-gic.h>
    #include <dt-bindings/interconnect/qcom,qcs8300-rpmh.h>
    #include <dt-bindings/power/qcom,rpmhpd.h>

    mdss: display-subsystem@ae00000 {
        compatible = "qcom,qcs8300-mdss";
        reg = <0 0x0ae00000 0 0x1000>;
        reg-names = "mdss";

        /* same path used twice */
        interconnects = <&mmss_noc MASTER_MDP0 0 &mc_virt SLAVE_EBI1 0>,
                        <&mmss_noc MASTER_MDP1 0 &mc_virt SLAVE_EBI1 0>,
                        <&gem_noc MASTER_APPSS_PROC QCOM_ICC_TAG_ACTIVE_ONLY
                        &config_noc SLAVE_DISPLAY_CFG QCOM_ICC_TAG_ACTIVE_ONLY>;
        interconnect-names = "mdp0-mem",
                             "mdp1-mem",
                             "cpu-cfg";

        power-domains = <&dispcc0 MDSS_DISP_CC_MDSS_CORE_GDSC>;

        clocks = <&dispcc0 MDSS_DISP_CC_MDSS_AHB_CLK>,
                 <&gcc GCC_DISP_HF_AXI_CLK>,
                 <&dispcc0 MDSS_DISP_CC_MDSS_MDP_CLK>;

        interrupts = <GIC_SPI 92 IRQ_TYPE_LEVEL_HIGH>;
        interrupt-controller;
        #interrupt-cells = <1>;

        iommus = <&apps_smmu 0x1000 0x402>;

        #address-cells = <2>;
        #size-cells = <2>;
        ranges;

        status = "disabled";

        mdss_mdp: display-controller@ae01000 {
            compatible = "qcom,qcs8300-dpu";
            reg = <0 0x0ae01000 0 0x8f000>,
                  <0 0x0aeb0000 0 0x2008>;
            reg-names = "mdp", "vbif";

            clocks = <&gcc GCC_DISP_HF_AXI_CLK>,
                     <&dispcc0 MDSS_DISP_CC_MDSS_AHB_CLK>,
                     <&dispcc0 MDSS_DISP_CC_MDSS_MDP_LUT_CLK>,
                     <&dispcc0 MDSS_DISP_CC_MDSS_MDP_CLK>,
                     <&dispcc0 MDSS_DISP_CC_MDSS_VSYNC_CLK>;
            clock-names = "bus",
                          "iface",
                          "lut",
                          "core",
                          "vsync";

            assigned-clocks = <&dispcc0 MDSS_DISP_CC_MDSS_VSYNC_CLK>;
            assigned-clock-rates = <19200000>;
            operating-points-v2 = <&mdp_opp_table>;
            power-domains = <&rpmhpd RPMHPD_MMCX>;

            interrupt-parent = <&mdss>;
            interrupts = <0>;
            ports {
                #address-cells = <1>;
                #size-cells = <0>;
                port@0 {
                    reg = <0>;
                    dpu_intf0_out: endpoint {
                         remote-endpoint = <&mdss_dp0_in>;
                    };
                };
            };

            mdp_opp_table: opp-table {
                compatible = "operating-points-v2";

                opp-375000000 {
                    opp-hz = /bits/ 64 <375000000>;
                    required-opps = <&rpmhpd_opp_svs_l1>;
                };

                opp-500000000 {
                    opp-hz = /bits/ 64 <500000000>;
                    required-opps = <&rpmhpd_opp_nom>;
                };

                opp-575000000 {
                    opp-hz = /bits/ 64 <575000000>;
                    required-opps = <&rpmhpd_opp_turbo>;
                };

                opp-650000000 {
                    opp-hz = /bits/ 64 <650000000>;
                    required-opps = <&rpmhpd_opp_turbo_l1>;
                };
            };
        };

        mdss_dp0: displayport-controller@af54000 {
            compatible = "qcom,qcs8300-dp";

            pinctrl-0 = <&dp_hot_plug_det>;
            pinctrl-names = "default";

            reg = <0 0xaf54000 0 0x104>,
                <0 0xaf54200 0 0x0c0>,
                <0 0xaf55000 0 0x770>,
                <0 0xaf56000 0 0x09c>;

            interrupt-parent = <&mdss>;
            interrupts = <12>;
            clocks = <&dispcc0 MDSS_DISP_CC_MDSS_AHB_CLK>,
                <&dispcc0 MDSS_DISP_CC_MDSS_DPTX0_AUX_CLK>,
                <&dispcc0 MDSS_DISP_CC_MDSS_DPTX0_LINK_CLK>,
                <&dispcc0 MDSS_DISP_CC_MDSS_DPTX0_LINK_INTF_CLK>,
                <&dispcc0 MDSS_DISP_CC_MDSS_DPTX0_PIXEL0_CLK>;
            clock-names = "core_iface",
                "core_aux",
                "ctrl_link",
                "ctrl_link_iface",
                "stream_pixel";
            assigned-clocks = <&dispcc0 MDSS_DISP_CC_MDSS_DPTX0_LINK_CLK_SRC>,
                 <&dispcc0 MDSS_DISP_CC_MDSS_DPTX0_PIXEL0_CLK_SRC>;
            assigned-clock-parents = <&mdss_edp_phy 0>, <&mdss_edp_phy 1>;
            phys = <&mdss_edp_phy>;
            phy-names = "dp";
            operating-points-v2 = <&dp_opp_table>;
            power-domains = <&rpmhpd QCS8300_MMCX>;
            #sound-dai-cells = <0>;
            status = "disabled";
            ports {
                #address-cells = <1>;
                #size-cells = <0>;
                port@0 {
                    reg = <0>;
                    mdss_dp0_in: endpoint {
                        remote-endpoint = <&dpu_intf0_out>;
                    };
                };
                port@1 {
                   reg = <1>;
                   mdss_dp_out: endpoint { };
                };
            };
            dp_opp_table: opp-table {
                compatible = "operating-points-v2";
                opp-160000000 {
                    opp-hz = /bits/ 64 <160000000>;
                    required-opps = <&rpmhpd_opp_low_svs>;
                };
                opp-270000000 {
                     opp-hz = /bits/ 64 <270000000>;
                     required-opps = <&rpmhpd_opp_svs>;
                };

                opp-540000000 {
                    opp-hz = /bits/ 64 <540000000>;
                    required-opps = <&rpmhpd_opp_svs_l1>;
                };
                opp-810000000 {
                    opp-hz = /bits/ 64 <810000000>;
                    required-opps = <&rpmhpd_opp_nom>;
                };
            };

    };
...
```

## Documentation/devicetree/bindings/display/msm/qcom,sa8775p-dpu.yaml
```yaml
# SPDX-License-Identifier: GPL-2.0-only OR BSD-2-Clause
%YAML 1.2
---
$id: http://devicetree.org/schemas/display/msm/qcom,sa8775p-dpu.yaml#
$schema: http://devicetree.org/meta-schemas/core.yaml#

title: Qualcomm Technologies, Inc. SA8775P Display DPU

maintainers:
  - Mahadevan <quic_mahap@quicinc.com>

$ref: /schemas/display/msm/dpu-common.yaml#

properties:
  compatible:
    enum:
      - qcom,qcs8300-dpu
      - qcom,sa8775p-dpu

  reg:
    items:
      - description: Address offset and size for mdp register set
      - description: Address offset and size for vbif register set

  reg-names:
    items:
      - const: mdp
      - const: vbif

  clocks:
    items:
      - description: Display hf axi
      - description: Display ahb
      - description: Display lut
      - description: Display core
      - description: Display vsync

  clock-names:
    items:
      - const: bus
      - const: iface
      - const: lut
      - const: core
      - const: vsync

required:
  - compatible
  - reg
  - reg-names
  - clocks
  - clock-names

unevaluatedProperties: false

examples:
  - |
    #include <dt-bindings/clock/qcom,sa8775p-dispcc.h>
    #include <dt-bindings/clock/qcom,gcc-sa8775p.h>
    #include <dt-bindings/interrupt-controller/arm-gic.h>
    #include <dt-bindings/interconnect/qcom,sa8775p.h>
    #include <dt-bindings/power/qcom,rpmhpd.h>

    display-controller@ae01000 {
        compatible = "qcom,sa8775p-dpu";
        reg = <0 0x0ae01000 0 0x8f000>,
              <0 0x0aeb0000 0 0x2008>;
        reg-names = "mdp", "vbif";

        clocks = <&gcc GCC_DISP_HF_AXI_CLK>,
                 <&dispcc0 MDSS_DISP_CC_MDSS_AHB_CLK>,
                 <&dispcc0 MDSS_DISP_CC_MDSS_MDP_LUT_CLK>,
                 <&dispcc0 MDSS_DISP_CC_MDSS_MDP_CLK>,
                 <&dispcc0 MDSS_DISP_CC_MDSS_VSYNC_CLK>;
        clock-names = "bus",
                      "iface",
                      "lut",
                      "core",
                      "vsync";

        assigned-clocks = <&dispcc0 MDSS_DISP_CC_MDSS_VSYNC_CLK>;
        assigned-clock-rates = <19200000>;
        operating-points-v2 = <&mdp_opp_table>;
        power-domains = <&rpmhpd RPMHPD_MMCX>;

        interrupt-parent = <&mdss>;
        interrupts = <0>;
        ports {
            #address-cells = <1>;
            #size-cells = <0>;
            port@0 {
                reg = <0>;
                dpu_intf0_out: endpoint {
                    remote-endpoint = <&mdss_dp0_in>;
                };
            };
        };

        mdp_opp_table: opp-table {
            compatible = "operating-points-v2";

            opp-375000000 {
                opp-hz = /bits/ 64 <375000000>;
                required-opps = <&rpmhpd_opp_svs_l1>;
            };

            opp-500000000 {
                opp-hz = /bits/ 64 <500000000>;
                required-opps = <&rpmhpd_opp_nom>;
            };

            opp-575000000 {
                opp-hz = /bits/ 64 <575000000>;
                required-opps = <&rpmhpd_opp_turbo>;
            };

            opp-650000000 {
                opp-hz = /bits/ 64 <650000000>;
                required-opps = <&rpmhpd_opp_turbo_l1>;
            };
        };
    };
...
```
