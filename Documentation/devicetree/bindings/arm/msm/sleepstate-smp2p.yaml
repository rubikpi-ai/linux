## Documentation/devicetree/bindings/net/qcom,xpcs.yaml
```yaml
# SPDX-License-Identifier: (GPL-2.0-only OR BSD-2-Clause)
%YAML 1.2
---
$id: http://devicetree.org/schemas/net/qcom,xpcs.yaml#
$schema: http://devicetree.org/meta-schemas/core.yaml#

title: Qualcomm Ethernet XPCS device

maintainers:
  - Sagar Cheluvegowda <quic_scheluve@quicinc.com>
  - Abhishek Chauhan <quic_abchauha@quicinc.com>

description:
  Synopsys DesignWare Ethernet Physical Coding Sublayer provides an interface
  between Media Access Control and Physical Medium Attachment Sublayer through
  the Media Independent Interface (XGMII, USXGMII, XLGMII, GMII, etc)
  controlled by means of the IEEE std. The PCS can be
  optionally synthesized with a vendor-specific interface connected to
  Synopsys PMA (also called DesignWare Consumer/Enterprise PHY) although in
  general it can be used to communicate with any compatible PHY.

  The PCS CSRs are being accessed via APB3 interfaces.


properties:
  compatible:
     enum:
     - qcom,xpcs

   reg:
    maxItems: 1

   reg-names:
    items:
      - const: qxpcs

   interrupts:
    minItems: 1
    items:
      - description:

   interrupt-names:
    minItems: 1
    items:
      - const:  pcs_intr

required:
  - compatible
  - reg

additionalProperties: false

examples:
  - |
    #include <dt-bindings/interrupt-controller/irq.h>

    xpcs0: xpcs@0x1A14000 {
            compatible = "qcom,xpcs";
            reg = <0x0 0x1A14000 0x0 0x5100>;
            reg-names = "qxpcs";
    };
```

## Documentation/devicetree/bindings/pci/qps615-switch.yaml
```yaml
# SPDX-License-Identifier: (GPL-2.0-only OR BSD-2-Clause)
%YAML 1.2
---
$id: http://devicetree.org/schemas/pci/qps615-switch.yaml#
$schema: http://devicetree.org/meta-schemas/core.yaml#

title: Qualcomm Technologies, Inc. (QTI)  PCIe switch

maintainers:
  - Chundru Krishna chaitanya <quic_krichai@quicinc.com>

properties:
  compatible:
    enum:
      - qcom,switch-i2c

  reg:
    maxItems: 1

  vdda-supply:
    description: A phandle to the core analog power supply

required:
  - compatible
  - reg
  - vdda-supply

additionalProperties: false

examples:
  - |
      i2c {
          #address-cells = <1>;
          #size-cells = <0>;
          qps615: pcie-switch@77 {
              compatible = "qcom,switch-i2c";
              reg = <0x077>;
              vdda-supply = <&foo>;
          };
      };
```

## Documentation/devicetree/bindings/phy/qcom,sc8280xp-qmp-usb3-uni-phy.yaml
```yaml
# SPDX-License-Identifier: (GPL-2.0 OR BSD-2-Clause)
%YAML 1.2
---
$id: http://devicetree.org/schemas/phy/qcom,sc8280xp-qmp-usb3-uni-phy.yaml#
$schema: http://devicetree.org/meta-schemas/core.yaml#

title: Qualcomm QMP PHY controller (USB, SC8280XP)

maintainers:
  - Vinod Koul <vkoul@kernel.org>

description:
  The QMP PHY controller supports physical layer functionality for a number of
  controllers on Qualcomm chipsets, such as, PCIe, UFS, and USB.

properties:
  compatible:
    enum:
      - qcom,ipq9574-qmp-usb3-phy
      - qcom,qcm2290-qmp-usb3-phy
      - qcom,qcs8300-qmp-usb3-uni-phy
      - qcom,sa7255p-qmp-usb3-uni-phy
      - qcom,sa8255p-qmp-usb3-uni-phy
      - qcom,sa8775p-qmp-usb3-uni-phy
      - qcom,sc8280xp-qmp-usb3-uni-phy
      - qcom,sdx75-qmp-usb3-uni-phy
      - qcom,sm6115-qmp-usb3-phy

  reg:
    maxItems: 1

  clocks:
    maxItems: 4

  clock-names:
    maxItems: 4

  power-domains:
    description: specifies phandles to PM domain provider nodes

  power-domain-names:
    items:
      - const: usb_transfer
      - const: usb_core

  resets:
    maxItems: 2

  reset-names:
    items:
      - const: phy
      - const: phy_phy

  vdda-phy-supply:
    description: phandle to phy supply

  vdda-pll-supply:
    description: phandle to phy PLL supply

  "#clock-cells":
    const: 0

  clock-output-names:
    maxItems: 1

  "#phy-cells":
    const: 0

required:
  - compatible
  - reg
  - "#phy-cells"

allOf:
  - if:
      properties:
        compatible:
          contains:
            enum:
              - qcom,ipq9574-qmp-usb3-phy
              - qcom,sdx75-qmp-usb3-uni-phy
    then:
      properties:
        clock-names:
          items:
            - const: aux
            - const: ref
            - const: cfg_ahb
            - const: pipe

  - if:
      properties:
        compatible:
          contains:
            enum:
              - qcom,qcm2290-qmp-usb3-phy
              - qcom,sm6115-qmp-usb3-phy
    then:
      properties:
        clocks:
          maxItems: 4
        clock-names:
          items:
            - const: cfg_ahb
            - const: ref
            - const: com_aux
            - const: pipe

  - if:
      properties:
        compatible:
          contains:
            enum:
              - qcom,qcs8300-qmp-usb3-uni-phy
              - qcom,sa8775p-qmp-usb3-uni-phy
              - qcom,sc8280xp-qmp-usb3-uni-phy
    then:
      properties:
        clocks:
          maxItems: 4
        clock-names:
          items:
            - const: aux
            - const: ref
            - const: com_aux
            - const: pipe
      required:
        - power-domains

  - if:
      properties:
        compatible:
          contains:
            enum:
              - qcom,sa7255p-qmp-usb3-uni-phy
              - qcom,sa8255p-qmp-usb3-uni-phy
    then:
      required:
        - power-domains
        - power-domain-names
      properties:
        power-domains:
          maxItems: 2
    else:
      required:
        - clocks
        - clock-names
        - resets
        - reset-names
        - vdda-phy-supply
        - vdda-pll-supply
        - clock-output-names
        - "#clock-cells"
      properties:
        power-domains:
          maxItems: 1


additionalProperties: false

examples:
  - |
    #include <dt-bindings/clock/qcom,gcc-sc8280xp.h>
    #include <dt-bindings/clock/qcom,rpmh.h>

    phy@88ef000 {
      compatible = "qcom,sc8280xp-qmp-usb3-uni-phy";
      reg = <0x088ef000 0x2000>;

      clocks = <&gcc GCC_USB3_MP_PHY_AUX_CLK>,
               <&gcc GCC_USB3_MP0_CLKREF_CLK>,
               <&gcc GCC_USB3_MP_PHY_COM_AUX_CLK>,
               <&gcc GCC_USB3_MP_PHY_PIPE_0_CLK>;
      clock-names = "aux", "ref", "com_aux", "pipe";

      power-domains = <&gcc USB30_MP_GDSC>;

      resets = <&gcc GCC_USB3_UNIPHY_MP0_BCR>,
               <&gcc GCC_USB3UNIPHY_PHY_MP0_BCR>;
      reset-names = "phy", "phy_phy";

      vdda-phy-supply = <&vreg_l3a>;
      vdda-pll-supply = <&vreg_l5a>;

      #clock-cells = <0>;
      clock-output-names = "usb2_phy0_pipe_clk";

      #phy-cells = <0>;
    };

  - |
    phy@88e8000 {
      compatible = "qcom,sa8255p-qmp-usb3-uni-phy";
      reg = <0x088e8000 0x2000>;
      #phy-cells = <0>;

      power-domains = <&scmi12_pd 2>, <&scmi12_pd 3>;
      power-domain-names = "usb_transfer", "usb_core";
    };
```
