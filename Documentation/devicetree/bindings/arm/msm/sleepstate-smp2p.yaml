## Documentation/devicetree/bindings/arm/msm/sleepstate-smp2p.yaml
```yaml
# SPDX-License-Identifier: (GPL-2.0-only OR BSD-2-Clause)
%YAML 1.2
---
$id: "http://devicetree.org/schemas/arm/msm/sleepstate-smp2p.yaml#"
$schema: "http://devicetree.org/meta-schemas/core.yaml#"

title: SMSM Point-to-Point (SMP2P) Sleepstate driver

maintainers:
  - Deepak Kumar Singh <quic_deesin@quicinc.com>
  - Arun Prakash P P <quic_app@quicinc.com>
  - Sarannya S <quic_sarannya@quicinc.com>

description: |+
  The smp2p_sleepstate driver operates as a callback to get notification from
  PM module on the system suspend state, and accordingly update smp2p bits.

properties:
  $nodename:
    const: qcom,smp2p_sleepstate
    description: Client to smp2p driver

  compatible:
    items:
      -const: qcom,smp2p-sleepstate

  qcom,smem-states:
    $ref: "/schemas/types.yaml#/definitions/phandle-array"
    maxItems: 1
    description: sleepstate_smp2p_out the relevant outgoing smp2p entry

  interrupt-parent:
    $ref: "/schemas/types.yaml#/definitions/phandle-array"
    maxItems: 1
    description: specifies the phandle to the parent interrupt controller

  interrupts:
    maxItems: 1
    description: specifies the interrupt number, the irq line to be used

  interrupt-names:
    maxItems: 1
    description: Interrupt name string, must be "smp2p-sleepstate-in"

required:
  - compatible

examples:
  - |
    qcom,smp2p_sleepstate {
      compatible = "qcom,smp2p-sleepstate";
      qcom,smem-states = <&sleepstate_smp2p_out 0>;
      interrupt-parent = <&sleepstate_smp2p_in>;
      interrupts = <0 0>;
      interrupt-names = "smp2p-sleepstate-in";
    };
```

## Documentation/devicetree/bindings/arm/qcom,coresight-remote-etm.yaml
```yaml
# SPDX-License-Identifier: GPL-2.0-only OR BSD-2-Clause
%YAML 1.2
---
$id: http://devicetree.org/schemas/arm/qcom,coresight-remote-etm.yaml#
$schema: http://devicetree.org/meta-schemas/core.yaml#

title: Qualcomm Coresight Remote ETM

maintainers:
  - Jinlong Mao <quic_jinlmao@quicinc.com>
  - Tao Zhang <quic_taozha@quicinc.com>

description: |
  Support for ETM trace collection on remote processor using coresight
  framework. Enabling this will allow turning on ETM tracing on remote
  processor via sysfs and collecting the trace via TMC sinks.

properties:
  compatible:
    items:
      - const: qcom,coresight-remote-etm

  qcom,inst-id:
    $ref: /schemas/types.yaml#/definitions/uint32
    description:
      Instance id of remote etm.

  out-ports:
    $ref: /schemas/graph.yaml#/properties/ports
    additionalProperties: false

    properties:
      port:
        description: Output connection to the CoreSight Trace bus.
        $ref: /schemas/graph.yaml#/properties/port

required:
  - compatible
  - qcom,inst-id
  - out-ports

unevaluatedProperties: false

examples:
  - |
    modem-etm0 {
        compatible = "qcom,coresight-remote-etm";
        qcom,inst-id = <2>;

        out-ports {
            port {
                modem_etm0_out_funnel_modem: endpoint {
                remote-endpoint =
                    <&funnel_modem_in_modem_etm0>;
                };
            };
        };
    };
...
```

## Documentation/devicetree/bindings/clock/qcom,sa8775p-camcc.yaml
```yaml
# SPDX-License-Identifier: (GPL-2.0-only OR BSD-2-Clause)
%YAML 1.2
---
$id: http://devicetree.org/schemas/clock/qcom,sa8775p-camcc.yaml#
$schema: http://devicetree.org/meta-schemas/core.yaml#

title: Qualcomm Technologies, Inc. Camera Clock & Reset Controller on SA8775P

maintainers:
  - Taniya Das <quic_tdas@quicinc.com>

description: |
  Qualcomm Technologies, Inc. camera clock control module provides the clocks, resets and power
  domains on SA8775p.

  See also::
    include/dt-bindings/clock/qcom,sa8775p-camcc.h

properties:
  compatible:
    enum:
      - qcom,sa8775p-camcc

  clocks:
    items:
      - description: Camera AHB clock from GCC
      - description: Board XO source
      - description: Board active XO source
      - description: Sleep clock source

  power-domains:
    maxItems: 1
    description:
      A phandle and PM domain specifier for the MMCX power domain.

  required-opps:
    maxItems: 1
    description:
      A phandle to an OPP node describing required MMCX performance point.

  '#clock-cells':
    const: 1

  '#reset-cells':
    const: 1

  '#power-domain-cells':
    const: 1

  reg:
    maxItems: 1

required:
  - compatible
  - reg
  - clocks
  - power-domains
  - required-opps
  - '#clock-cells'
  - '#reset-cells'
  - '#power-domain-cells'

additionalProperties: false

examples:
  - |
    #include <dt-bindings/clock/qcom,rpmh.h>
    #include <dt-bindings/power/qcom-rpmpd.h>
    #include <dt-bindings/clock/qcom,sa8775p-gcc.h>
    clock-controller@ade0000 {
      compatible = "qcom,sa8775p-camcc";
      reg = <0x0ade0000 0x20000>;
      clocks = <&gcc GCC_CAMERA_AHB_CLK>,
               <&rpmhcc RPMH_CXO_CLK>,
               <&rpmhcc RPMH_CXO_CLK_A>,
               <&sleep_clk>;
      power-domains = <&rpmhpd SA8775P_MMCX>;
      required-opps = <&rpmhpd_opp_low_svs>;
      #clock-cells = <1>;
      #reset-cells = <1>;
      #power-domain-cells = <1>;
    };
...
```

## Documentation/devicetree/bindings/clock/qcom,sa8775p-dispcc.yaml
```yaml
# SPDX-License-Identifier: (GPL-2.0-only OR BSD-2-Clause)
%YAML 1.2
---
$id: http://devicetree.org/schemas/clock/qcom,dispcc-sa8775p.yaml#
$schema: http://devicetree.org/meta-schemas/core.yaml#

title: Qualcomm Technologies, Inc. Display Clock & Reset Controller on SA8775P

maintainers:
  - Taniya Das <quic_tdas@quicinc.com>

description: |
  Qualcomm Technologies, Inc. display clock control module provides the clocks, resets and power
  domains on SA8775P.

  See also:: include/dt-bindings/clock/qcom,sa8775p-dispcc.h

properties:
  compatible:
    const: qcom,sa8775p-dispcc0
    const: qcom,sa8775p-dispcc1

  clocks:
    items:
      - description: GCC AHB clock source
      - description: Board XO source
      - description: Board XO_AO source
      - description: Sleep clock source
      - description: Link clock from DP0 PHY
      - description: VCO DIV clock from DP0 PHY
      - description: Link clock from DP1 PHY
      - description: VCO DIV clock from DP1 PHY
      - description: Byte clock from DSI0 PHY
      - description: Pixel clock from DSI0 PHY
      - description: Byte clock from DSI1 PHY
      - description: Pixel clock from DSI1 PHY

  '#clock-cells':
    const: 1

  '#reset-cells':
    const: 1

  '#power-domain-cells':
    const: 1

  reg:
    maxItems: 1

  power-domains:
    description:
      A phandle and PM domain specifier for the MMCX power domain.
    maxItems: 1

  required-opps:
    description:
      A phandle to an OPP node describing required MMCX performance point.
    maxItems: 1

required:
  - compatible
  - reg
  - clocks
  - '#clock-cells'
  - '#reset-cells'
  - '#power-domain-cells'

additionalProperties: false

examples:
  - |
    #include <dt-bindings/clock/qcom,rpmh.h>
    #include <dt-bindings/power/qcom-rpmpd.h>
    #include <dt-bindings/clock/qcom,sa8755p-gcc.h>
    clock-controller@af00000 {
      compatible = "qcom,sa8755p-dispcc0";
      reg = <0x0af00000 0x20000>;
      clocks = <&gcc GCC_DISP_AHB_CLK>,
               <&rpmhcc RPMH_CXO_CLK>,
               <&rpmhcc RPMH_CXO_CLK_A>,
               <&sleep_clk>,
               <0>, <0>, <0>, <0>,
               <&dsi_phy0 0>,
               <&dsi_phy0 1>
               <&dsi_phy1 2>,
               <&dsi_phy1 3>;
      power-domains = <&rpmhpd SA8775P_MMCX>;
      required-opps = <&rpmhpd_opp_low_svs>;
      #clock-cells = <1>;
      #reset-cells = <1>;
      #power-domain-cells = <1>;
    };
...
```

## Documentation/devicetree/bindings/clock/qcom,sa8775p-videocc.yaml
```yaml
# SPDX-License-Identifier: (GPL-2.0-only OR BSD-2-Clause)
%YAML 1.2
---
$id: http://devicetree.org/schemas/clock/qcom,sa8775p-videocc.yaml#
$schema: http://devicetree.org/meta-schemas/core.yaml#

title: Qualcomm Technologies, Inc. Video Clock & Reset Controller on SA8775P

maintainers:
  - Taniya Das <quic_tdas@quicinc.com>

description: |
  Qualcomm Technologies, Inc. video clock control module provides the clocks, resets and power
  domains on SA8775P.

  See also:: include/dt-bindings/clock/qcom,sa8775p-videocc.h

properties:
  compatible:
    enum:
      - qcom,sa8775p-videocc

  reg:
    maxItems: 1

  clocks:
    items:
      - description: Video AHB clock from GCC
      - description: Board XO source
      - description: Board active XO source
      - description: Sleep Clock source

  power-domains:
    maxItems: 1
    description:
      MMCX power domain.

  required-opps:
    maxItems: 1
    description:
      A phandle to an OPP node describing required MMCX performance point.

  '#clock-cells':
    const: 1

  '#reset-cells':
    const: 1

  '#power-domain-cells':
    const: 1

required:
  - compatible
  - reg
  - clocks
  - power-domains
  - required-opps
  - '#clock-cells'
  - '#reset-cells'
  - '#power-domain-cells'

additionalProperties: false

examples:
  - |
    #include <dt-bindings/clock/qcom,rpmh.h>
    #include <dt-bindings/power/qcom-rpmpd.h>
    #include <dt-bindings/clock/qcom,sa8775p-gcc.h>
    videocc: clock-controller@abf0000 {
      compatible = "qcom,sa8775p-videocc";
      reg = <0x0abf0000 0x10000>;
      clocks = <&gcc GCC_VIDEO_AHB_CLK>,
               <&rpmhcc RPMH_CXO_CLK>,
               <&rpmhcc RPMH_CXO_CLK_A>,
               <&sleep_clk>;
      power-domains = <&rpmhpd SA8775P_MMCX>;
      required-opps = <&rpmhpd_opp_low_svs>;
      #clock-cells = <1>;
      #reset-cells = <1>;
      #power-domain-cells = <1>;
    };
...
```

## Documentation/devicetree/bindings/crypto/qcom,inline-crypto-engine.yaml
```yaml
# SPDX-License-Identifier: (GPL-2.0-only OR BSD-2-Clause)
%YAML 1.2
---
$id: http://devicetree.org/schemas/crypto/qcom,inline-crypto-engine.yaml#
$schema: http://devicetree.org/meta-schemas/core.yaml#

title: Qualcomm Technologies, Inc. (QTI) Inline Crypto Engine

maintainers:
  - Bjorn Andersson <andersson@kernel.org>

properties:
  compatible:
    items:
      - enum:
          - qcom,sa8255p-inline-crypto-engine
          - qcom,sm8450-inline-crypto-engine
          - qcom,sm8550-inline-crypto-engine
          - qcom,sm8650-inline-crypto-engine
      - const: qcom,inline-crypto-engine

  reg:
    maxItems: 1

  clocks:
    maxItems: 1

  qcom,ice-use-hwkm:
    type: boolean
    description:
      Use the supported Hardware Key Manager (HWKM) in Qualcomm
      ICE to support wrapped keys. This dictates if wrapped keys
      have to be used by ICE.

  qcom,ice-skip-clk:
    type: boolean
    description:
      Skip to get GCC_UFS_PHY_ICE_CORE_CLK in ICE driver. This
      dictates if ICE driver request this clock on/off.

required:
  - compatible
  - reg
  - oneof:
    - clocks
    - qcom,ice-skip-clk

additionalProperties: false

examples:
  - |
    #include <dt-bindings/clock/qcom,sm8550-gcc.h>

    crypto@1d88000 {
      compatible = "qcom,sm8550-inline-crypto-engine",
                   "qcom,inline-crypto-engine";
      reg = <0x01d88000 0x8000>;
      clocks = <&gcc GCC_UFS_PHY_ICE_CORE_CLK>;
    };

  - |
    crypto@1d88000 {
      compatible = "qcom,sa8255p-inline-crypto-engine",
                   "qcom,inline-crypto-engine",
      reg = <0x01d88000 0x8000>;
      qcom,ice-skip-clk;
    };
...
```
