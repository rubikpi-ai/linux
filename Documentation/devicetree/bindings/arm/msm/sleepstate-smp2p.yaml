## Documentation/devicetree/bindings/iio/adc/qcom,spmi-adc5-gen3.yaml
```yaml
# SPDX-License-Identifier: (GPL-2.0-only OR BSD-2-Clause)
%YAML 1.2
---
$id: http://devicetree.org/schemas/iio/adc/qcom,spmi-adc5-gen3.yaml#
$schema: http://devicetree.org/meta-schemas/core.yaml#

title: Qualcomm's SPMI PMIC ADC5 Gen3

maintainers:
  - Jishnu Prakash <quic_jprakash@quicinc.com>

description: |
  SPMI PMIC5 Gen3 voltage ADC (ADC) provides interface to
  clients to read voltage. It is a 16-bit sigma-delta ADC.
  It also performs the same thermal monitoring function as
  the existing ADC_TM devices.

properties:
  compatible:
    const: qcom,spmi-adc5-gen3

  reg:
    description: |
      - Each reg corresponds to an SDAM peripheral base address that is being used for ADC.

  '#address-cells':
    const: 1

  '#size-cells':
    const: 0

  "#thermal-sensor-cells":
    const: 1
    description:
      Number of cells required to uniquely identify the thermal sensors. Since
      we have multiple sensors this is set to 1. This property is required for
      ADC devices with channels used for TM (thermal monitoring) functionality.

  '#io-channel-cells':
    const: 1

  interrupts:
    description: |
      End of conversion interrupt. Interrupts are defined for each SDAM being used.

  interrupt-names:
    minItems: 1
    maxItems: 10
    items:
      pattern: "^adc-sdam[0-9]+$"
    description: |
      Names should be defined as "adc-sdam<N>" where <N> represents the SDAM index.

required:
  - compatible
  - reg
  - '#address-cells'
  - '#size-cells'
  - '#io-channel-cells'
  - interrupts
  - interrupt-names

patternProperties:
  "^channel@[0-9a-f]+$":
    type: object
    additionalProperties: false
    description: |
      Represents the external channels which are connected to the ADC.

    properties:
      reg:
        maxItems: 1
        description: |
          ADC channel number.
          See include/dt-bindings/iio/qcom,spmi-vadc.h
          For PMIC5 Gen3 ADC, the channel numbers are specified separately
          per PMIC in the PMIC-specific files in include/dt-bindings/iio/.

      label:
        $ref: /schemas/types.yaml#/definitions/string
        description: |
            ADC input of the platform as seen in the schematics.
            For thermistor inputs connected to generic AMUX or GPIO inputs
            these can vary across platform for the same pins. Hence select
            the platform schematics name for this channel.

      qcom,decimation:
        $ref: /schemas/types.yaml#/definitions/uint32
        description: |
            This parameter is used to decrease ADC sampling rate.
            Quicker measurements can be made by reducing decimation ratio.
        enum: [ 85, 340, 1360 ]
        default: 1360

      qcom,pre-scaling:
        description: |
            Used for scaling the channel input signal before the signal is
            fed to VADC. The configuration for this node is to know the
            pre-determined ratio and use it for post scaling. It is a pair of
            integers, denoting the numerator and denominator of the fraction by which
            input signal is multiplied. For example, <1 3> indicates the signal is scaled
            down to 1/3 of its value before ADC measurement.
            If property is not found default value depending on chip will be used.
        $ref: /schemas/types.yaml#/definitions/uint32-array
        items:
          - const: 1
          - enum: [ 1, 3, 6, 16 ]

      qcom,ratiometric:
        description: |
            Channel calibration type.
            - If this property is specified VADC will use the VDD reference (1.875V)
              and GND for channel calibration. If property is not found, channel will be
              calibrated with 0V and 1.25V reference channels, also known as
              absolute calibration.
        type: boolean

      qcom,hw-settle-time:
        $ref: /schemas/types.yaml#/definitions/uint32
        description: |
            Time between AMUX getting configured and the ADC starting
            conversion. The 'hw_settle_time' is an index used from valid values
            and programmed in hardware to achieve the hardware settling delay.
        enum: [ 15, 100, 200, 300, 400, 500, 600, 700, 1000, 2000, 4000,
                8000, 16000, 32000, 64000, 128000 ]
        default: 15

      qcom,avg-samples:
        $ref: /schemas/types.yaml#/definitions/uint32
        description: |
            Number of samples to be used for measurement.
            Averaging provides the option to obtain a single measurement
            from the ADC that is an average of multiple samples. The value
            selected is 2^(value).
        enum: [ 1, 2, 4, 8, 16 ]
        default: 1

      qcom,adc-tm:
        description: |
            Indicates if ADC_TM monitoring is done on this channel.
            Defined for compatible property "qcom,spmi-adc5-gen3".
            This is the same functionality as in the existing QCOM ADC_TM
            device, documented at devicetree/bindings/thermal/qcom-spmi-adc-tm5.yaml.
        type: boolean

    required:
      - reg

additionalProperties: false

examples:
  - |
    #include <dt-bindings/iio/qcom,spmi-adc5-gen3-pmk8550.h>
    #include <dt-bindings/iio/qcom,spmi-adc5-gen3-pm8550.h>
    #include <dt-bindings/iio/qcom,spmi-adc5-gen3-pm8550b.h>
    #include <dt-bindings/iio/qcom,spmi-adc5-gen3-pm8550vx.h>
    #include <dt-bindings/interrupt-controller/irq.h>

    pmic {
      #address-cells = <1>;
      #size-cells = <0>;

      /* VADC node */
      pmk8550_vadc: vadc@9000 {
        compatible = "qcom,spmi-adc5-gen3";
        reg = <0x9000>, <0x9100>;
        interrupts = <0x0 0x90 0x1 IRQ_TYPE_EDGE_RISING>,
                <0x0 0x91 0x1 IRQ_TYPE_EDGE_RISING>;
        interrupt-names = "adc-sdam0", "adc-sdam1";
        #address-cells = <1>;
        #size-cells = <0>;
        #io-channel-cells = <1>;
        #thermal-sensor-cells = <1>;

        /* PMK8550 Channel nodes */
        channel@3 {
          reg = <PMK8550_ADC5_GEN3_DIE_TEMP>;
          label = "pmk8550_die_temp";
          qcom,pre-scaling = <1 1>;
        };

        channel@44 {
          reg = <PMK8550_ADC5_GEN3_AMUX_THM1_XO_THERM_100K_PU>;
          label = "pmk8550_xo_therm";
          qcom,pre-scaling = <1 1>;
          qcom,ratiometric;
          qcom,hw-settle-time = <200>;
          qcom,adc-tm;
        };

        /* PM8550 Channel nodes */
        channel@103 {
          reg = <PM8550_ADC5_GEN3_DIE_TEMP>;
          label = "pm8550_die_temp";
          qcom,pre-scaling = <1 1>;
        };

        /* PM8550B Channel nodes */
        channel@78f {
          reg = <PM8550B_ADC5_GEN3_VBAT_SNS_QBG>;
          label = "pm8550b_vbat_sns_qbg";
          qcom,pre-scaling = <1 3>;
        };

        /* PM8550VS_C Channel nodes */
        channel@203 {
          reg = <PM8550VS_ADC5_GEN3_DIE_TEMP(2)>;
          label = "pm8550vs_c_die_temp";
          qcom,pre-scaling = <1 1>;
        };
      };
    };
```

## Documentation/devicetree/bindings/interconnect/qcom,qcs8300-rpmh.yaml
```yaml
# SPDX-License-Identifier: GPL-2.0-only OR BSD-2-Clause
%YAML 1.2
---
$id: http://devicetree.org/schemas/interconnect/qcom,qcs8300-rpmh.yaml#
$schema: http://devicetree.org/meta-schemas/core.yaml#

title: Qualcomm Technologies, Inc. RPMh Network-On-Chip Interconnect on QCS8300

maintainers:
  - Bjorn Andersson <andersson@kernel.org>
  - Konrad Dybcio <konrad.dybcio@linaro.org>

description: |
  RPMh interconnect providers support system bandwidth requirements through
  RPMh hardware accelerators known as Bus Clock Manager (BCM).

  See also:: include/dt-bindings/interconnect/qcom,qcs8300.h

properties:
  compatible:
    enum:
      - qcom,qcs8300-aggre1-noc
      - qcom,qcs8300-aggre2-noc
      - qcom,qcs8300-clk-virt
      - qcom,qcs8300-config-noc
      - qcom,qcs8300-dc-noc
      - qcom,qcs8300-gem-noc
      - qcom,qcs8300-gpdsp-anoc
      - qcom,qcs8300-lpass-ag-noc
      - qcom,qcs8300-mc-virt
      - qcom,qcs8300-mmss-noc
      - qcom,qcs8300-nspa-noc
      - qcom,qcs8300-pcie-anoc
      - qcom,qcs8300-system-noc

  reg:
    maxItems: 1

required:
  - compatible

unevaluatedProperties: false

examples:
  - |
    gem_noc: interconnect-gem-noc {
        compatible = "qcom,qcs8300-gem-noc";
        #interconnect-cells = <2>;
        qcom,bcm-voters = <&apps_bcm_voter>;
    };
```

## Documentation/devicetree/bindings/iommu/qcom,qsmmuv500-tbu.yaml
```yaml
# SPDX-License-Identifier: (GPL-2.0-only OR BSD-2-Clause)
%YAML 1.2
---
$id: http://devicetree.org/schemas/iommu/qcom,qsmmuv500-tbu.yaml#
$schema: http://devicetree.org/meta-schemas/core.yaml#

title: Qualcomm Technologies, Inc. TBU (Translation Buffer Unit)

maintainers:
  - Georgi Djakov <quic_c_gdjako@quicinc.com>

description:
  The Qualcomm Technologies, Inc. SMMU500 implementation consists of TCU and
  TBU. The TBU contains a Translation Lookaside Buffer (TLB) that caches page
  tables. TBUs provides debug features to trace and trigger debug transactions.
  There are multiple TBU instances distributes with each client core.

properties:
  $nodename:
    pattern: "^tbu@[0-9a-f]+$"

  compatible:
    const: qcom,qsmmuv500-tbu

  reg:
    items:
      - description: Address and size of the TBU's register space.

  reg-names:
    items:
      - const: base

  clocks:
    maxItems: 1

  interconnects:
    maxItems: 1

  power-domains:
    maxItems: 1

  qcom,stream-id-range:
    $ref: /schemas/types.yaml#/definitions/uint32-array
    description: Stream ID range (address and size) that is assigned by the TBU
    items:
      minItems: 2
      maxItems: 2

required:
  - compatible
  - reg
  - interconnects
  - qcom,stream-id-range

additionalProperties: false

examples:
  - |
    #include <dt-bindings/clock/qcom,gcc-sdm845.h>
    #include <dt-bindings/interconnect/qcom,icc.h>
    #include <dt-bindings/interconnect/qcom,sdm845.h>
    #include <dt-bindings/interrupt-controller/arm-gic.h>
    #include <dt-bindings/interrupt-controller/irq.h>
    #include <dt-bindings/power/qcom-rpmpd.h>

    apps_smmu: iommu@15000000 {
        compatible = "qcom,sdm845-smmu-500", "arm,mmu-500";
        reg = <0x15000000 0x80000>;
        ranges = <0 0 0 0 0xffffffff>;
        #iommu-cells = <2>;
        #global-interrupts = <1>;
        interrupts = <GIC_SPI 65 IRQ_TYPE_LEVEL_HIGH>,
                     <GIC_SPI 343 IRQ_TYPE_LEVEL_HIGH>;
        #address-cells = <2>;
        #size-cells = <2>;

        anoc_1_pcie_tbu: tbu@150e1000 {
            compatible = "qcom,qsmmuv500-tbu";
            reg = <0x0 0x150e1000 0x0 0x1000>;
            reg-names = "base";
            clocks = <&gcc GCC_AGGRE_NOC_PCIE_TBU_CLK>;
            interconnects = <&system_noc MASTER_GNOC_SNOC QCOM_ICC_TAG_ACTIVE_ONLY
                             &config_noc SLAVE_IMEM_CFG QCOM_ICC_TAG_ACTIVE_ONLY>;
            power-domains = <&gcc HLOS1_VOTE_AGGRE_NOC_MMU_PCIE_TBU_GDSC>;
            qcom,stream-id-range = <0x1c00 0x400>;
        };
    };

...
```
