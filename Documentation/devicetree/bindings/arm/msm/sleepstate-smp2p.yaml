## Documentation/devicetree/bindings/firmware/qcom,platform-parts-info.yaml
```yaml
# SPDX-License-Identifier: GPL-2.0-only OR BSD-2-Clause
%YAML 1.2
---
$id: http://devicetree.org/schemas/firmware/qcom,platform-parts-info.yaml#
$schema: http://devicetree.org/meta-schemas/core.yaml#

title: QCOM Platform's Parts Information

description:
  Qualcomm platforms support a feature where a subset of hardware blocks
  like Camera, GPU, Display, Modem, CPUs are available in a product,
  based on features selected for a particular Stock keeping unit (SKU)
  and the same software images are supposed to work seamlessly with these.
  This is to support usecases where lets say a software image running on handset
  device which supports display and camera, can work just fine on another
  IoT product which doesn't need these. This also enables usecases, where certain
  sub parts for a HW block are not supported.

  Firmware reads the parts related information from lower layers and passes this
  information to kernel via this device tree interface, so that the respective
  clients are aware of it.
  For example, camera drivers and its user space daemons can use this interface
  to know if camera is not supported on the device or if a certain sub-feature inside
  camera is not supported.

  Firmware also reads SKU details and board information like memory card's serial
  number and populates it in new device tree nodes.

maintainers:
  - Naman Jain <quic_namajain@quicinc.com>

properties:
  $nodename:
    const: qcom,platform-parts-info

  serial-number:
    description:
      Serial number of the memory device used - UFS, NAND or EMMC. If none of them is found,
      this will return SoC's serial number.
    $ref: /schemas/types.yaml#/definitions/uint32

  pcode:
    description:
      Product code used for the Stock Keeping Unit (SKU) for the device. If its not supported,
      value of the property is UINT32_MAX, i.e. all bits will be set.
    $ref: /schemas/types.yaml#/definitions/uint32

  feature-code:
    description:
      Feature Code used for the Stock Keeping Unit (SKU) for the device. This has values like
      AA, AB, AC etc for external parts, and Y0, Y1, Y3 etc for internal parts. "Unknown" if SKU
      information is not supported for a platform.
    $ref: /schemas/types.yaml#/definitions/string

  subset-cores:
    description:
      A bitmask value, encoded from LSB with a set bit corresponding to actual physical CPU
      not supported on the SoC.
    $ref: /schemas/types.yaml#/definitions/uint32

  subset-parts:
    description:
      A bitmask value, encoded from LSB with a set bit corresponding to a particular part
      not supported on the SoC. Starting from LSB 1, parts correspond to GPU, Video, Camera,
      Display, Audio, Modem, WLAN, Compute, Sensors, NPU, SPSS, NAV, Compute1, Display1, NSP,
      EVA and PCIE.
    $ref: /schemas/types.yaml#/definitions/uint32

patternProperties:
  "^subset-(gpu|video|camera|display|audio|modem|wlan|compute|sensors|npu|spss|nav|compute1|display1|nsp|eva|pcie)+$":
    type: object
    properties:
      part-count:
        description:
          Number of instances available for a particular part type.
          If the value is UINT32_MAX, i.e. all bits set, then that value is invalid and not to be
          considered.
        $ref: /schemas/types.yaml#/definitions/uint32
      part-info:
        description:
          Bitmap array with number of entries same as part-count. Each entry stores information
          related to subset of features/sub-parts supported for a particular instance of a part
          type. Each bitmask value, has its 0th bit set if that part is completely not supported.
          Otherwise, rest of the bits will correspond to specific functionalities
          of that part not supported.
          If the value is UINT32_MAX, i.e. all bits set, then that value is invalid and not to be
          considered.
        $ref: /schemas/types.yaml#/definitions/uint32-array

required:
  - serial-number
  - pcode
  - feature-code

additionalProperties: false

examples:
  - |
    firmware {
        qcom,platform-parts-info {         /* populated by firmware */
            serial-number = <0x12345678>;
            pcode = <0x1>;
            feature-code = "AA";
            subset-parts = <0x12>;    /* GPU and Display are completely not supported */
            subset-cores = <0x90>;    /* CPU 4 and 7 are not supported */
            subset-camera {
                part-count = <0x1>;   /* Single instance of camera is supported */
                part-info = <0x0>;    /* Camera is fully supported */
            };
            subset-video {
                part-count = <0x2>;   /* 2 instances of video are supported */
                part-info = <0x0 0x101>; /* Few sub-parts of second Video part are not supported */
            };
            subset-modem {
                part-count = <0xffffffff>;   /* Invalid/Unsupported value, do not refer */
                part-info = <0xffffffff>; /* Invalid/Unsupported value, do not refer */
            };
        };
    };
...
```

## Documentation/devicetree/bindings/firmware/qcom,smcinvoke.yaml
```yaml
# SPDX-License-Identifier: (GPL-2.0-only OR BSD-2-Clause)
%YAML 1.2
---
$id: http://devicetree.org/schemas/firmware/qcom,smcinvoke.yaml#
$schema: http://devicetree.org/meta-schemas/core.yaml#

title: SMCInvoke driver to provide transport between TZ and HLOS.

description:
   This facilitates the communication and data transfer between
   Trust Zone and REE(Rich execution environment).

maintainers:
  - Vikas Kumar Sharma <quic_vksharma@quicinc.com>

properties:
  compatible:
    const: qcom,smcinvoke

  qcom,support-legacy_smc:
    type: boolean
    description: Define property to use legacy based scm call.

  memory-region:
    maxItems: 1
    description: Handle to reserve memory region.

required:
  - compatible

additionalProperties: false

examples:
  - |
	reserved-memory {
		qseecom_mem: qcom,qseecom {
			compatible = "shared-dma-pool";
			alloc-ranges = <0x0 0x00000000 0x0 0xffffffff>;
			reusable;
			alignment = <0x0 0x400000>;
			size = <0x0 0x1400000>; /* 20M */
		};

		qseecom_ta_mem: qcom,qseecom-ta {
			compatible = "shared-dma-pool";
			alloc-ranges = <0x0 0x00000000 0x0 0xffffffff>;
			reusable;
			alignment = <0x0 0x400000>;
			size = <0x0 0x1000000>; /* 16M */
		};
	};

    firmware {
        qcom_smcinvoke {
            compatible = "qcom,smcinvoke";
            memory-region = <&qseecom_mem &qseecom_ta_mem>;
        };
    };
```

## Documentation/devicetree/bindings/firmware/qcom,tz-log.yaml
```yaml
# SPDX-License-Identifier: (GPL-2.0-only OR BSD-2-Clause)
%YAML 1.2
---
$id: http://devicetree.org/schemas/firmware/qcom,tz-log.yaml#
$schema: http://devicetree.org/meta-schemas/core.yaml#

title: TZLOG (Trust Zone log)

maintainers:
  - Vikas Kumar Sharma <quic_vksharma@quicinc.com>

description:
  This exposes a debug interface for accessing and displaying diagnostic information
  related to secure code (Trustzone/QSEE).

properties:
  compatible:
    const: qcom,tz-log

  reg:
    maxItems: 1

  qcom,hyplog-enabled:
    type: boolean
    description: Indicates(boolean) if driver supports HYP logger service.

  hyplog-address-offset:
    $ref: /schemas/types.yaml#/definitions/uint32
    description: Register offset to get the HYP log base address.

  hyplog-size-offset:
    $ref: /schemas/types.yaml#/definitions/uint32
    description: Register offset to get the HYP log size parameter.

  rmlog-address:
    $ref: /schemas/types.yaml#/definitions/uint32
    description: Register offset to get resource manager log base address.

  rmlog-size:
    $ref: /schemas/types.yaml#/definitions/uint32
    description: Register offset to get the resource manager log size parameter.

  tmecrashdump-address-offset:
    $ref: /schemas/types.yaml#/definitions/uint32
    description: Define tme crashump DDR region starting offset.

required:
  - compatible
  - reg

additionalProperties: false

examples:
  - |
    soc {
        #address-cells = <2>;
        #size-cells = <2>;

        qcom_tzlog: tz-log@146bf720 {
            compatible = "qcom,tz-log";
            reg = <0x0 0x146bf720 0x0 0x3000>;
            qcom,hyplog-enabled;
            hyplog-address-offset = <0x410>;
            hyplog-size-offset = <0x414>;
        };
    };
```

## Documentation/devicetree/bindings/i2c/qcom,i2c-geni-qcom.yaml
```yaml
# SPDX-License-Identifier: (GPL-2.0-only OR BSD-2-Clause)
%YAML 1.2
---
$id: http://devicetree.org/schemas/i2c/qcom,i2c-geni-qcom.yaml#
$schema: http://devicetree.org/meta-schemas/core.yaml#

title: Qualcomm Geni based QUP I2C Controller

maintainers:
  - Andy Gross <agross@kernel.org>
  - Bjorn Andersson <bjorn.andersson@linaro.org>

properties:
  compatible:
    enum:
      - qcom,geni-i2c
      - qcom,geni-i2c-master-hub
      - qcom,sa7255p-geni-i2c
      - qcom,sa8255p-geni-i2c

  clocks:
    description: phandles for the clock providers

  clock-names:
    description: names for the clocks

  clock-frequency:
    default: 100000

  dmas:
    maxItems: 2

  dma-names:
    items:
      - const: tx
      - const: rx

  interconnects:
    description: phandles of interconnect bw provider

  interconnect-names:
    items:
      - const: qup-core
      - const: qup-config
      - const: qup-memory

  interrupts:
    maxItems: 1

  operating-points-v2: true

  pinctrl-0: true
  pinctrl-1: true

  pinctrl-names:
    minItems: 1
    items:
      - const: default
      - const: sleep

  power-domains:
    maxItems: 1

  reg:
    maxItems: 1

  required-opps:
    maxItems: 1

  qcom,load-firmware: true
    description: Optional property which indicate if QUP firmware to be loaded from Linux.

  qcom,xfer-mode:
    const: 1
    description: Value 1,2 and 3 represents FIFO, CPU DMA and GSI DMA mode respectively. This is an optional property.

required:
  - compatible
  - interrupts
  - reg

allOf:
  - $ref: /schemas/i2c/i2c-controller.yaml#
  - if:
      properties:
        compatible:
          contains:
            const: qcom,geni-i2c-master-hub
    then:
      properties:
        clocks:
          minItems: 2

        clock-names:
          items:
            - const: se
            - const: core

        dmas: false
        dma-names: false

        interconnects:
          maxItems: 2

        interconnect-names:
          items:
            - const: qup-core
            - const: qup-config
  - if:
      properties:
        compatible:
          contains:
            enum:
              - qcom,sa7255p-geni-i2c
              - qcom,sa8255p-geni-i2c
    then:
      required:
        - power-domains
    else:
      properties:
        clocks:
          minItems: 1
          maxItems: 2
        clock-names:
          minItems: 1
          maxItems: 2
        interconnects:
          minItems: 2
          maxItems: 3
        interconnect-names:
          minItems: 2
          maxItems: 3

unevaluatedProperties: false

examples:
  - |
    #include <dt-bindings/interrupt-controller/arm-gic.h>
    #include <dt-bindings/clock/qcom,gcc-sc7180.h>
    #include <dt-bindings/interconnect/qcom,sc7180.h>
    #include <dt-bindings/power/qcom-rpmpd.h>

    i2c@88000 {
        compatible = "qcom,geni-i2c";
        reg = <0x00880000 0x4000>;
        clock-names = "se";
        clocks = <&gcc GCC_QUPV3_WRAP0_S0_CLK>;
        pinctrl-names = "default";
        pinctrl-0 = <&qup_i2c0_default>;
        interrupts = <GIC_SPI 601 IRQ_TYPE_LEVEL_HIGH>;
        #address-cells = <1>;
        #size-cells = <0>;
        interconnects = <&qup_virt MASTER_QUP_CORE_0 0 &qup_virt SLAVE_QUP_CORE_0 0>,
                        <&gem_noc MASTER_APPSS_PROC 0 &config_noc SLAVE_QUP_0 0>,
                        <&aggre1_noc MASTER_QUP_0 0 &mc_virt SLAVE_EBI1 0>;
        interconnect-names = "qup-core", "qup-config", "qup-memory";
        power-domains = <&rpmhpd SC7180_CX>;
        required-opps = <&rpmhpd_opp_low_svs>;
        qcom,load-firmware;
        qcom, xfer-mode = <1>;
    };

  - |
    #include <dt-bindings/interrupt-controller/arm-gic.h>

    i2c@984000 {
        compatible = "qcom,sa8255p-geni-i2c";
        reg = <0x984000 0x4000>;
        interrupts = <GIC_SPI 551 IRQ_TYPE_LEVEL_HIGH>;
        #address-cells = <1>;
        #size-cells = <0>;
        power-domains = <&scmi9_pd 11>;
    };
...
```
