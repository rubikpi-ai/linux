## Documentation/devicetree/bindings/media/qcom,sm8550-iris.yaml
```yaml
# SPDX-License-Identifier: (GPL-2.0-only OR BSD-2-Clause)
%YAML 1.2
---
$id: http://devicetree.org/schemas/media/qcom,sm8550-iris.yaml#
$schema: http://devicetree.org/meta-schemas/core.yaml#

title: Qualcomm IRIS video encode and decode accelerators

maintainers:
  - Vikash Garodia <quic_vgarodia@quicinc.com>
  - Dikshita Agarwal <quic_dikshita@quicinc.com>

description:
  The Iris video processing unit is a video encode and decode accelerator
  present on Qualcomm platforms.

properties:
  compatible:
    oneOf:
      - enum:
          - qcom,sm8550-iris

  reg:
    maxItems: 2

  interrupts:
    maxItems: 1

  power-domains:
    minItems: 2
    maxItems: 4

  power-domain-names:
    oneOf:
      - items:
          - const: iris-ctl
          - const: vcodec
          - const: mx
          - const: mmcx

  operating-points-v2: true

  clocks:
    maxItems: 3

  clock-names:
    items:
      - const: gcc_video_axi0
      - const: core_clk
      - const: vcodec_core

  interconnects:
    maxItems: 2

  interconnect-names:
    items:
      - const: venus-cnoc
      - const: venus-ddr

  memory-region:
    maxItems: 1

  resets:
    maxItems: 1

  reset-names:
    items:
      - const: video_axi_reset

  iommus:
    maxItems: 2

  dma-coherent: true

  opp-table:
    type: object

required:
  - compatible
  - reg
  - interrupts
  - power-domains
  - power-domain-names
  - clocks
  - clock-names
  - interconnects
  - interconnect-names
  - memory-region
  - resets
  - reset-names
  - iommus
  - dma-coherent
  - opp-table

additionalProperties: false

examples:
  - |
    #include <dt-bindings/clock/qcom,rpmh.h>
    #include <dt-bindings/clock/qcom,sm8550-gcc.h>
    #include <dt-bindings/clock/qcom,sm8450-videocc.h>
    #include <dt-bindings/interrupt-controller/arm-gic.h>
    #include <dt-bindings/interconnect/qcom,sm8550-rpmh.h>
    #include <dt-bindings/power/qcom-rpmpd.h>

    iris: video-codec@aa00000 {
        compatible = "qcom,sm8550-iris";
        status = "okay";

        reg = <0 0x0aa00000 0 0xf0000>;
        interrupts = <GIC_SPI 174 IRQ_TYPE_LEVEL_HIGH>;

        power-domains = <&videocc VIDEO_CC_MVS0C_GDSC>,
                        <&videocc VIDEO_CC_MVS0_GDSC>,
                        <&rpmhpd SM8550_MXC>,
                        <&rpmhpd SM8550_MMCX>;
        power-domain-names = "iris-ctl", "vcodec", "mxc", "mmcx";
        operating-points-v2 = <&iris_opp_table>;

        clocks = <&gcc GCC_VIDEO_AXI0_CLK>,
                 <&videocc VIDEO_CC_MVS0C_CLK>,
                 <&videocc VIDEO_CC_MVS0_CLK>;
        clock-names = "gcc_video_axi0", "core_clk", "vcodec_core";

        interconnects = <&gem_noc MASTER_APPSS_PROC 0 &config_noc SLAVE_VENUS_CFG 0>,
                        <&mmss_noc MASTER_VIDEO 0 &mc_virt SLAVE_EBI1 0>;
        interconnect-names = "venus-cnoc", "venus-ddr";

        /* FW load region */
        memory-region = <&video_mem>;

        resets = <&gcc GCC_VIDEO_AXI0_CLK_ARES>;
        reset-names = "video_axi_reset";

        iommus = <&apps_smmu 0x1947 0x0000>,
                 <&apps_smmu 0x1940 0x0000>;
        dma-coherent;

        iris_opp_table: opp-table {
            compatible = "operating-points-v2";

            opp-240000000 {
                opp-hz = /bits/ 64 <240000000>;
                required-opps = <&rpmhpd_opp_svs>,
                                <&rpmhpd_opp_low_svs>;
           };

           opp-338000000 {
               opp-hz = /bits/ 64 <338000000>;
               required-opps = <&rpmhpd_opp_svs>,
                               <&rpmhpd_opp_svs>;
           };

           opp-366000000 {
               opp-hz = /bits/ 64 <366000000>;
               required-opps = <&rpmhpd_opp_svs_l1>,
                               <&rpmhpd_opp_svs_l1>;
           };

           opp-444000000 {
               opp-hz = /bits/ 64 <444000000>;
               required-opps = <&rpmhpd_opp_turbo>,
                               <&rpmhpd_opp_turbo>;
           };

           opp-533333334 {
               opp-hz = /bits/ 64 <533333334>;
               required-opps = <&rpmhpd_opp_turbo_l1>,
                               <&rpmhpd_opp_turbo_l1>;
           };
       };
    };
...
```

## Documentation/devicetree/bindings/mfd/qcom-i2c-pmic.yaml
```yaml
# SPDX-License-Identifier: GPL-2.0-only OR BSD-2-Clause
%YAML 1.2
---
$id: http://devicetree.org/schemas/mfd/qcom-i2c-pmic.yaml#
$schema: http://devicetree.org/meta-schemas/core.yaml#

title: Qualcomm Technologies, Inc. I2C PMIC Interrupt Controller

maintainers:
  - Umang Chheda <quic_uchheda@quicinc.com>

description: |
  The I2C PMIC Controller is used by multi-function PMIC devices which communicate
  over the I2C bus. An I2C PMIC controller node typically contains one or more
  child nodes representing the device's peripherals. Each of the peripherals
  typically has its own driver on the platform bus and will be enumerated by this
  controller. The controller exposes a regmap to the peripherals to communicate
  over the I2C bus.

  The controller also controls interrupts for all of the peripherals on the bus.
  The controller takes a summary interrupt, deciphers which peripheral triggered
  the interrupt, and which of the peripheral's interrupts were triggered. Finally,
  it calls the handlers for each of the virtual interrupts that were registered.

properties:
  compatible:
    const: qcom,i2c-pmic

  reg:
    description:
      7-bit I2C address of the device.

    maxItems: 1

  '#address-cells':
    const: 1

  '#size-cells':
    const: 0

  pinctrl-names:
    const: default

  pinctrl-0:
    description:
      phandle of the pin configuration.

    maxItems: 1

patternProperties:
  "^pm8008-chip@[0-9]+$":
    type: object
    $ref: /schemas/regulator/qcom,pm8008-chip.yaml#

  "^qcom,pm8008[a-z]-regulator+$":
    type: object
    $ref: /schemas/regulator/qcom,pm8008-regulator.yaml#

required:
  - compatible
  - reg

additionalProperties: false

examples:
  - |
    #include <dt-bindings/interrupt-controller/irq.h>

    i2c_3 {
      status = "okay";
      #address-cells = <1>;
      #size-cells = <0>;

      qcom,smb138x@8 {
        compatible = "qcom,i2c-pmic";
        reg = <0x8>;
        #address-cells = <1>;
        #size-cells = <0>;
        pinctrl-names = "default";
        pinctrl-0 = <&smb_stat_active>;
      };
    };

  - |
    #include <dt-bindings/interrupt-controller/irq.h>

    i2c1 {
      status = "okay";
      #address-cells = <1>;
      #size-cells = <0>;

      pm8008i_chip: pm8008i@8 {
        compatible = "qcom,i2c-pmic";
        reg = <0x8>;
        #address-cells = <1>;
        #size-cells = <0>;

        pinctrl-names = "default";
        pinctrl-0 = <&pm8008i_active>;

        pm8008-chip@900 {
          compatible = "qcom,pm8008-chip";
          reg = <0x900>;

          PM8008I_EN: qcom,pm8008-chip-en {
            regulator-name = "pm8008i-chip-en";
          };
        };
      };
    };

...
```

## Documentation/devicetree/bindings/misc/qcom,dcc.yaml
```yaml
# SPDX-License-Identifier: (GPL-2.0-only OR BSD-2-Clause)
%YAML 1.2
---
$id: http://devicetree.org/schemas/misc/qcom,dcc.yaml#
$schema: http://devicetree.org/meta-schemas/core.yaml#

title: Data Capture and Compare

maintainers:
  - Sreenad Menon <quic_sreemeno@quicinc.com>

description: |
    DCC (Data Capture and Compare) is a DMA engine which is used to save
    configuration data or system memory contents during catastrophic failure
    or SW trigger. DCC is used to capture and store data for debugging purpose

properties:
  compatible:
    items:
      - enum:
          - qcom,dcc-v1
          - qcom,dcc-v2
          - qcom,dcc-v3

  reg:
    items:
      - description: DCC base
      - description: DCC RAM base

  qcom,dcc-offset:
    $ref: /schemas/types.yaml#/definitions/uint32
    description:
      The offset of the DCC SRAM from DCC SRAM base.

required:
  - compatible
  - reg

additionalProperties: false

examples:
  - |
    dma@10a2000{
        compatible = "qcom,dcc-v3";
        reg = <0x010a2000 0x1000>,
              <0x010ad000 0x2000>;
        qcom,dcc-offset = <0>
    };
```

## Documentation/devicetree/bindings/net/qcom,ethqos.yaml
```yaml
# SPDX-License-Identifier: GPL-2.0 OR BSD-2-Clause
%YAML 1.2
---
$id: http://devicetree.org/schemas/net/qcom,ethqos.yaml#
$schema: http://devicetree.org/meta-schemas/core.yaml#

title: Qualcomm Ethernet ETHQOS device

maintainers:
  - Bhupesh Sharma <bhupesh.sharma@linaro.org>

description:
  dwmmac based Qualcomm ethernet devices which support Gigabit
  ethernet (version v2.3.0 and onwards).

allOf:
  - $ref: snps,dwmac.yaml#
  - if:
      properties:
        compatible:
          contains:
            enum:
              - qcom,sa7255p-ethqos
              - qcom,sa8255p-ethqos
    then:
      required:
        - power-domains
        - power-domain-names
      properties:
        power-domains:
          minItems: 3
          maxItems: 3
        power-domain-names:
          items:
            - const: power_core
            - const: power_mdio
            - const: perf_serdes
    else:
      required:
        - clocks
        - clock-names
      properties:
        clocks:
          maxItems: 4
        clock-names:
          items:
            - const: stmmaceth
            - const: pclk
            - const: ptp_ref
            - enum:
                - rgmii
                - phyaux
        phys: true
        phy-names:
          const: serdes

properties:
  compatible:
    enum:
      - qcom,qcs404-ethqos
      - qcom,qcs8300-ethqos
      - qcom,sa7255p-ethqos
      - qcom,sa8255p-ethqos
      - qcom,sa8775p-ethqos
      - qcom,sc8280xp-ethqos
      - qcom,sm8150-ethqos

  reg:
    maxItems: 2

  reg-names:
    items:
      - const: stmmaceth
      - const: rgmii

  interrupts:
    minItems: 1
    items:
      - description: Combined signal for various interrupt events
      - description: The interrupt that occurs when Rx exits the LPI state
      - description: The interrupt that occurs when HW safety error triggered

  interrupt-names:
    minItems: 1
    items:
      - const: macirq
      - enum: [eth_lpi, sfty]
      - const: sfty

  clocks:
    description: phandles of clock providers

  clock-names:
    description: names of the clocks

  power-domains:
    description: phandle for the power domain provider

  power-domain-names:
    description: power domain names if multiple domains are used

  iommus:
    maxItems: 1

  dma-coherent: true

  phys:
    description: phandle of the phy

  phy-names:
    description: phy name

required:
  - compatible
  - reg-names

unevaluatedProperties: false

examples:
  - |
    #include <dt-bindings/interrupt-controller/arm-gic.h>
    #include <dt-bindings/clock/qcom,gcc-qcs404.h>
    #include <dt-bindings/gpio/gpio.h>

    ethernet: ethernet@7a80000 {
      compatible = "qcom,qcs404-ethqos";
      reg = <0x07a80000 0x10000>,
            <0x07a96000 0x100>;
      reg-names = "stmmaceth", "rgmii";
      clock-names = "stmmaceth", "pclk", "ptp_ref", "rgmii";
      clocks = <&gcc GCC_ETH_AXI_CLK>,
               <&gcc GCC_ETH_SLAVE_AHB_CLK>,
               <&gcc GCC_ETH_PTP_CLK>,
               <&gcc GCC_ETH_RGMII_CLK>;
      interrupts = <GIC_SPI 56 IRQ_TYPE_LEVEL_HIGH>,
                   <GIC_SPI 55 IRQ_TYPE_LEVEL_HIGH>,
                   <GIC_SPI 782 IRQ_TYPE_LEVEL_HIGH>;
      interrupt-names = "macirq", "eth_lpi", "sfty";

      rx-fifo-depth = <4096>;
      tx-fifo-depth = <4096>;

      snps,tso;
      snps,reset-gpio = <&tlmm 60 GPIO_ACTIVE_LOW>;
      snps,reset-active-low;
      snps,reset-delays-us = <0 10000 10000>;

      pinctrl-names = "default";
      pinctrl-0 = <&ethernet_defaults>;

      phy-handle = <&phy1>;
      phy-mode = "rgmii";
      mdio {
        #address-cells = <0x1>;
        #size-cells = <0x0>;

        compatible = "snps,dwmac-mdio";
        phy1: phy@4 {
          compatible = "ethernet-phy-ieee802.3-c22";
          device_type = "ethernet-phy";
          reg = <0x4>;

          #phy-cells = <0>;
        };
      };
    };

  - |
    #include <dt-bindings/interrupt-controller/arm-gic.h>
    #include <dt-bindings/gpio/gpio.h>

    ethernet@23000000 {
      compatible = "qcom,sa8255p-ethqos";
      reg = <0x23000000 0x10000>,
            <0x23016000 0x100>;
      reg-names = "stmmaceth", "rgmii";

      interrupts = <GIC_SPI 929 IRQ_TYPE_LEVEL_HIGH>;
      interrupt-names = "macirq";

      iommus = <&apps_smmu 0x140 0xf>;

      snps,tso;
      snps,pbl = <32>;
      rx-fifo-depth = <16384>;
      tx-fifo-depth = <16384>;

      phy-mode = "sgmii";
      phy-handle = <&sgmii_phy1>;

      snps,mtl-rx-config = <&mtl_rx_setup1>;
      snps,mtl-tx-config = <&mtl_tx_setup1>;
      snps,ps-speed = <1000>;

      power-domains = <&scmi8_pd 0>, <&scmi8_pd 1>, <&scmi8_dvfs 0>;
      power-domain-names = "power_core", "power_mdio","perf_serdes";

      mdio {
        compatible = "snps,dwmac-mdio";
        #address-cells = <1>;
        #size-cells = <0>;

        sgmii_phy1: phy@a {
          compatible = "ethernet-phy-id0141.0dd4";
          reg = <0xa>;
          device_type = "ethernet-phy";
          resets = <&scmi8_rst 0>;
          reset-names = "phy";
          reset-assert-us = <11000>;
          reset-deassert-us = <70000>;
        };
      };

      mtl_rx_setup1: rx-queues-config {
        snps,rx-queues-to-use = <4>;
        snps,rx-sched-sp;

        queue0 {
          snps,dcb-algorithm;
          snps,map-to-dma-channel = <0x0>;
          snps,route-up;
          snps,priority = <0x1>;
        };

        queue1 {
          snps,dcb-algorithm;
          snps,map-to-dma-channel = <0x1>;
          snps,route-ptp;
        };

        queue2 {
          snps,avb-algorithm;
          snps,map-to-dma-channel = <0x2>;
          snps,route-avcp;
        };

        queue3 {
          snps,avb-algorithm;
          snps,map-to-dma-channel = <0x3>;
          snps,priority = <0xc>;
        };
      };

      mtl_tx_setup1: tx-queues-config {
        snps,tx-queues-to-use = <4>;
        snps,tx-sched-sp;

        queue0 {
          snps,dcb-algorithm;
        };

        queue1 {
          snps,dcb-algorithm;
        };

        queue2 {
          snps,avb-algorithm;
          snps,send_slope = <0x1000>;
          snps,idle_slope = <0x1000>;
          snps,high_credit = <0x3e800>;
          snps,low_credit = <0xffc18000>;
        };

        queue3 {
          snps,avb-algorithm;
          snps,send_slope = <0x1000>;
          snps,idle_slope = <0x1000>;
          snps,high_credit = <0x3e800>;
          snps,low_credit = <0xffc18000>;
        };
      };
    };
```
